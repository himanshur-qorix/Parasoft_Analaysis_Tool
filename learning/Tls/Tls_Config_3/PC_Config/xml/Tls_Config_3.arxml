AUTOSAR XML (schema 00053)
package /ARRoot
  module config EcuC_0: definition=EcuC, ecuc-def-edition=4.2.2, implementation-config-variant=VARIANT-PRE-COMPILE
    EcucPostBuildVariants_0 (EcucPostBuildVariants): EcucPostBuildVariantRef=(unset)
  module config TcpIp_0: definition=TcpIp, ecuc-def-edition=4.9.0, implementation-config-variant=VARIANT-PRE-COMPILE
    TcpIpConfig_0 (TcpIpConfig)
      TcpIpCtrl_0 (TcpIpCtrl): TcpIpEthIfCtrlRef=(unset)
        TcpIpIpVXCtrl_0 (TcpIpIpVXCtrl)
      TcpIpLocalAddr_0 (TcpIpLocalAddr): TcpIpAddressType=, TcpIpAddrId=(unset), TcpIpDomainType=, TcpIpCtrlRef=(unset)
        TcpIpAddrAssignment_0 (TcpIpAddrAssignment): TcpIpAssignmentMethod=, TcpIpAssignmentPriority=(unset), TcpIpAssignmentTrigger=
      TcpIpSocketOwnerConfig_0 (TcpIpSocketOwnerConfig)
        TcpIpSocketOwner_0 (TcpIpSocketOwner): TcpIpSocketOwnerId=0, TcpIpSocketOwnerUpperLayerType=
      TcpIpTlsConfig_0 (TcpIpTlsConfig): TcpIpTlsMaxConnections=(unset), TcpIpTlsCsmRandomGenerateJobRef=(unset)
        TcpIpTlsCiphersuites_0 (TcpIpTlsCiphersuites)
          TcpIpTlsCertificateIdentity_0 (TcpIpTlsCertificateIdentity)
          TcpIpTlsCiphersuiteDefinition_0 (TcpIpTlsCiphersuiteDefinition):
            TcpIpTlsCiphersuiteId = (unset)
            TcpIpTlsCiphersuitePriority = (unset)
            TcpIpTlsUseAEADCipher = false
            TcpIpTlsUsePresharedKeys = false
            TcpIpTlsUseSecurityExtensionForceEncryptThenMac = false
            TcpIpTlsVersion = 
          TcpIpTlsCiphersuiteWorker_0 (TcpIpTlsCiphersuiteWorker):
            TcpIpTlsCipherCsmMacGenerateJobRef = (unset)
            TcpIpTlsCipherCsmMacGenerateKeyRef = (unset)
            TcpIpTlsCipherCsmMacVerifyJobRef = (unset)
            TcpIpTlsCipherCsmMacVerifyKeyRef = (unset)
            TcpIpTlsCiphersuiteDefinitionRef = (unset)
            TcpIpTlsConnectionHandshakeRef = (unset)
          TcpIpTlsHandshake_0 (TcpIpTlsHandshake): TcpIpTlsCsmHashVerifyJobRef=(unset), TcpIpTlsCsmPrfMacJobRef=(unset), TcpIpTlsCsmPrfMacKeyRef=(unset)
        6 x TcpIpTlsConnection, all with TcpIpTlsConnectionType=, TcpIpTlsMaxFragmentLength=(unset), TcpIpTlsUseExtensionCertificateStatusRequest=false, TcpIpTlsUseExtensionMaxFragmentLength=false, TcpIpTlsUseExtensionRecordSizeLimit=false, TcpIpTlsUseExtensionTrustedCAKeys=false, TcpIpTlsCertificateIdentityRef=(unset), TcpIpTlsConnectionCiphersuiteWorkerRef=(unset):
          TcpIpTlsConnection_{0..5}: TcpIpTlsConnectionId={0..5}
    TcpIpGeneral_0 (TcpIpGeneral):
      TcpIpBufferMemory = (unset)
      TcpIpDevErrorDetect = false
      TcpIpDhcpServerEnabled = (unset)
      TcpIpEnableSecurityEventReporting = false
      TcpIpGetAndResetMeasurementDataApi = (unset)
      TcpIpMainFunctionPeriod = (unset)
      TcpIpResetIpAssignmentApi = (unset)
      TcpIpScalabilityClass = 
      TcpIpTcpEnabled = (unset)
      TcpIpTcpSocketMax = (unset)
      TcpIpUdpEnabled = (unset)
      TcpIpUdpSocketMax = (unset)
      TcpIpVersionInfoApi = false
      TcpIpIpV4General_0 (TcpIpIpV4General):
        TcpIpArpEnabled = (unset)
        TcpIpAutoIpEnabled = (unset)
        TcpIpDhcpClientEnabled = (unset)
        TcpIpIcmpEnabled = (unset)
        TcpIpIpV4Enabled = (unset)
        TcpIpLocalAddrIpv4EntriesMax = (unset)
        TcpIpPathMtuDiscoveryEnabled = (unset)
      TcpIpIpV6General_0 (TcpIpIpV6General):
        TcpIpDhcpV6ClientEnabled = (unset)
        TcpIpIpV6Enabled = (unset)
        TcpIpIpV6PathMtuDiscoveryEnabled = (unset)
        TcpIpLocalAddrIpv6EntriesMax = (unset)
        TcpIpNdpAddressResolutionUnrechabilityDetectionEnabled = (unset)
        TcpIpNdpPrefixAndRouterDiscoveryEnabled = (unset)
  module config Tls_0: definition=Tls, ecuc-def-edition=4.9.0, implementation-config-variant=VARIANT-PRE-COMPILE, module-description=Tls_Impl
    TlsConfig_0 (TlsConfig): TlsMaxConnections=2
      TlsCiphersuites_0 (TlsCiphersuites): TlsCsmHKDFSupportType=TLS_HKDF_CSM_NO_SUPPORT
        TlsCertificateIdentity_0 (TlsCertificateIdentity): TlsCipherKeyMRemoteCertificate=KeyMCertificate_Server_0
        3 x TlsCiphersuiteDefinition, all with TlsUseAEADCipher=false, TlsUsePresharedKeys=false, TlsUseSecurityExtensionForceEncryptThenMac=false, TlsVersion=TLS_VERSION_V13:
          TlsCiphersuiteDefinition_0: TlsCiphersuiteId=0x1301, TlsCiphersuitePriority=1, TlsCiphersuiteName=TLS_AES_128_GCM_SHA256
          TlsCiphersuiteDefinition_1: TlsCiphersuiteName=TLS_AES_256_GCM_SHA384, TlsCiphersuiteId=0x1302, TlsCiphersuitePriority=2
          TlsCiphersuiteDefinition_2: TlsCiphersuiteId=0x1303, TlsCiphersuitePriority=3
        4 x TlsCiphersuiteWorker, all with TlsCipherEncryptKeyLength=82:
          TlsCiphersuiteWorker_0: TlsCipherCsmMacGenerateJobRef=CipherCsmMacGenerateJob_0, TlsCipherCsmMacGenerateKeyRef=CipherCsmMacGenerateKey_0, TlsCipherCsmMacVerifyJobRef=CipherCsmMacVerifyJob_0, TlsCipherCsmMacVerifyKeyRef=CipherCsmMacVerifyKey_0, TlsCiphersuiteDefinitionRef=TlsCiphersuiteDefinition_2, TlsConnectionHandshakeRef=TlsHandshake_0, TlsCsmClientApplicationTrafficSecretKeyRef=ClientApplicationTrafficSecretKey_0, TlsCsmClientApplicationWriteIV=ClientApplicationWriteIV_0, TlsCsmClientApplicationWriteKeyRef=ClientApplicationWriteKey_0, TlsCsmServerApplicationTrafficSecretKeyRef=ServerApplicationTrafficSecretKey_0, TlsCsmServerApplicationWriteIV=ServerApplicationWriteIV_0, TlsCsmServerApplicationWriteKeyRef=ServerApplicationWriteKey_0
          TlsCiphersuiteWorker_1: TlsCiphersuiteDefinitionRef=TlsCiphersuiteDefinition_1, TlsCipherCsmMacGenerateJobRef=CipherCsmMacGenerateJob_1, TlsCipherCsmMacGenerateKeyRef=CipherCsmMacGenerateKey_1, TlsCipherCsmMacVerifyJobRef=CipherCsmMacVerifyJob_1, TlsCipherCsmMacVerifyKeyRef=CipherCsmMacVerifyKey_1, TlsConnectionHandshakeRef=TlsHandshake_1, TlsCsmClientApplicationTrafficSecretKeyRef=ClientApplicationTrafficSecretKey_1, TlsCsmClientApplicationWriteIV=ClientApplicationWriteIV_1, TlsCsmClientApplicationWriteKeyRef=ClientApplicationWriteKey_1, TlsCsmServerApplicationTrafficSecretKeyRef=ServerApplicationTrafficSecretKey_1, TlsCsmServerApplicationWriteIV=ServerApplicationWriteIV_1, TlsCsmServerApplicationWriteKeyRef=ServerApplicationWriteKey_1, TlsCipherCsmDecryptJobRef=CipherCsmDecryptJob_1, TlsCipherCsmDecryptKeyRef=CipherCsmDecryptKey_1, TlsCipherCsmEncryptJobRef=CipherCsmEncryptJob_1, TlsCipherCsmEncryptKeyRef=CipherCsmEncryptKey_1
          TlsCiphersuiteWorker_2: TlsCipherCsmMacGenerateJobRef=CipherCsmMacGenerateJob_2, TlsCipherCsmMacGenerateKeyRef=CipherCsmMacGenerateKey_2, TlsCipherCsmMacVerifyJobRef=CipherCsmMacVerifyJob_2, TlsCipherCsmMacVerifyKeyRef=CipherCsmMacVerifyKey_2, TlsCiphersuiteDefinitionRef=TlsCiphersuiteDefinition_0, TlsConnectionHandshakeRef=TlsHandshake_0, TlsCsmClientApplicationTrafficSecretKeyRef=ClientApplicationTrafficSecretKey_2, TlsCsmClientApplicationWriteIV=ClientApplicationWriteIV_2, TlsCsmClientApplicationWriteKeyRef=ClientApplicationWriteKey_2, TlsCsmServerApplicationTrafficSecretKeyRef=ServerApplicationTrafficSecretKey_2, TlsCsmServerApplicationWriteIV=ServerApplicationWriteIV_2, TlsCsmServerApplicationWriteKeyRef=ServerApplicationWriteKey_2
          TlsCiphersuiteWorker_3: TlsCipherCsmMacGenerateJobRef=CipherCsmMacGenerateJob_3, TlsCipherCsmMacGenerateKeyRef=CipherCsmMacGenerateKey_3, TlsCipherCsmMacVerifyJobRef=CipherCsmMacVerifyJob_3, TlsCipherCsmMacVerifyKeyRef=CipherCsmMacVerifyKey_3, TlsCiphersuiteDefinitionRef=TlsCiphersuiteDefinition_0, TlsConnectionHandshakeRef=TlsHandshake_2, TlsCsmClientApplicationTrafficSecretKeyRef=ClientApplicationTrafficSecretKey_3, TlsCsmClientApplicationWriteIV=ClientApplicationWriteIV_3, TlsCsmClientApplicationWriteKeyRef=ClientApplicationWriteKey_3, TlsCsmServerApplicationTrafficSecretKeyRef=ServerApplicationTrafficSecretKey_3, TlsCsmServerApplicationWriteIV=ServerApplicationWriteIV_3, TlsCsmServerApplicationWriteKeyRef=ServerApplicationWriteKey_3
        3 x TlsHandshake:
          TlsHandshake_0: index=1, TlsCsmPRFSupportType=TLS_PRF_NO_SUPPORT, TlsSignatureAlgorithmType=TLS_RSA_PKCS1_SHA256, TlsSupportedEllipticCurveGroupType=TLS_SECP256R1, TlsCsmHashVerifyJobRef=HashVerifyJob_0, TlsCsmPrfMacJobRef=PrfMacJob_0, TlsCsmPrfMacKeyRef=PrfMacKey_0, TlsCsmClientHandshakeTrafficSecretKeyRef=ClientHandshakeTrafficSecretKey_0, TlsCsmClientHandshakeWriteIV=ClientHandshakeWriteIV_0, TlsCsmClientHandshakeWritekeyRef=ClientHandshakeWritekey_0, TlsCsmDerivedKeyRef=DerivedKey_0, TlsCsmEarlySecretKeyRef=EarlySecretKey_0, TlsCsmHandshakeSecretKeyRef=HandshakeSecretKey_0, TlsCsmHKDFExpandJobRef=HKDFExpandJob_0, TlsCsmHKDFExpandKeyRef=HKDFExpandKey_0, TlsCsmHKDFExtractJobRef=HKDFExtractJob_0, TlsCsmHKDFExtractKeyRef=HKDFExtractKey_0, TlsCsmMasterSecretKeyRef=MasterKey_0, TlsCsmServerHandshakeTrafficSecretKeyRef=ServerHandshakeTrafficSecretKey_0, TlsCsmServerHandshakeWriteIV=ServerApplicationWriteIV_0, TlsCsmServerHandshakeWritekeyRef=ServerHandshakeWritekey_0, TlsCsmKeyExchangeCalcPubValJobRef=TlsCsmKeyExchangeCalcPubValJobRef_0, TlsCsmKeyExchangeCalcSecretJobRef=TlsCsmKeyExchangeCalcSecretJobRef_0, TlsCsmKeyExchangeSignatureGenerateJobRef=SigGenJob_0, TlsCsmKeyExchangeSignatureGenerateKeyRef=SigGenKey_0, TlsCsmKeyExchangeSignatureVerifyJobRef=SigVerifyJob_0, TlsCsmKeyExchangeSignatureVerifyKeyRef=SigVerifyKey_0, TlsCsmKeyExchangeKeyRef=TlsCsmKeyExchangeKeyRef_0
          TlsHandshake_1: index=2, TlsSignatureAlgorithmType=TLS_RSA_PSS_PSS_SHA256, TlsSupportedEllipticCurveGroupType=TLS_X25519, TlsCsmHashVerifyJobRef=HashVerifyJob_1, TlsCsmPrfMacJobRef=PrfMacJob_1, TlsCsmPrfMacKeyRef=PrfMacKey_1, TlsCsmClientHandshakeTrafficSecretKeyRef=ClientHandshakeTrafficSecretKey_1, TlsCsmClientHandshakeWriteIV=ClientHandshakeWriteIV_1, TlsCsmClientHandshakeWritekeyRef=ClientHandshakeWritekey_1, TlsCsmDerivedKeyRef=DerivedKey_1, TlsCsmEarlySecretKeyRef=EarlySecretKey_1, TlsCsmHandshakeSecretKeyRef=HandshakeSecretKey_1, TlsCsmHKDFExpandJobRef=HKDFExpandJob_1, TlsCsmHKDFExpandKeyRef=HKDFExpandKey_1, TlsCsmHKDFExtractJobRef=HKDFExtractJob_1, TlsCsmHKDFExtractKeyRef=HKDFExtractKey_1, TlsCsmMasterSecretKeyRef=MasterKey_1, TlsCsmServerHandshakeTrafficSecretKeyRef=ServerHandshakeTrafficSecretKey_1, TlsCsmServerHandshakeWriteIV=ServerHandshakeWriteIV_1, TlsCsmServerHandshakeWritekeyRef=ServerApplicationWriteKey_1, TlsCsmKeyExchangeCalcPubValJobRef=TlsCsmKeyExchangeCalcPubValJobRef_1, TlsCsmKeyExchangeCalcSecretJobRef=TlsCsmKeyExchangeCalcSecretJobRef_1, TlsCsmKeyExchangeKeyRef=TlsCsmKeyExchangeKeyRef_1, TlsCsmKeyExchangeSignatureGenerateJobRef=SigGenJob_1, TlsCsmKeyExchangeSignatureGenerateKeyRef=SigGenKey_1, TlsCsmKeyExchangeSignatureVerifyJobRef=SigVerifyJob_1, TlsCsmKeyExchangeSignatureVerifyKeyRef=SigVerifyKey_1
          TlsHandshake_2: index=3, TlsCsmClientHandshakeTrafficSecretKeyRef=ClientHandshakeTrafficSecretKey_2, TlsCsmClientHandshakeWriteIV=ClientHandshakeWriteIV_2, TlsCsmClientHandshakeWritekeyRef=ClientHandshakeWritekey_2, TlsCsmDerivedKeyRef=DerivedKey_2, TlsCsmEarlySecretKeyRef=EarlySecretKey_2, TlsCsmHandshakeSecretKeyRef=HandshakeSecretKey_2, TlsCsmHashVerifyJobRef=HashVerifyJob_2, TlsCsmHKDFExpandJobRef=HKDFExpandJob_2, TlsCsmHKDFExpandKeyRef=HKDFExtractKey_2, TlsCsmHKDFExtractJobRef=HKDFExtractJob_2, TlsCsmHKDFExtractKeyRef=HKDFExtractKey_2, TlsCsmMasterSecretKeyRef=MasterKey_2, TlsCsmPrfMacJobRef=PrfMacJob_2, TlsCsmPrfMacKeyRef=PrfMacKey_2, TlsCsmServerHandshakeTrafficSecretKeyRef=ServerHandshakeTrafficSecretKey_2, TlsCsmServerHandshakeWriteIV=ServerHandshakeWriteIV_2, TlsCsmServerHandshakeWritekeyRef=ServerHandshakeWritekey_2
        13 x TlsPskIdentity:
          TlsPskIdentity_0: TlsPresharedKeyIdentity=My_Secret_Password-0, TlsPresharedKeyCsmKeyRef=PSK_0, TlsCsmBinderKeyRef=BinderKey_0_PSK_0
          TlsPskIdentity_1: TlsPskGetClientKeyIdentityFunc=PSK_CBK1_TlsClientGetPskIdentity, TlsCsmBinderKeyRef=BinderKey_1_PSK_1
          TlsPskIdentity_10_server: TlsPskGetKeyIdentityHintFunc=PSK_CBK4_TlsServerGetPskIdentityHint, TlsPskGetServerKeyIdentityFunc=PSK_CBK4_TlsServerGetPskIdentity, TlsCsmBinderKeyRef=BinderKey_10_PSK_10
          TlsPskIdentity_11_server: TlsPresharedKeyIdentityHint=My_Secret_Password-5, TlsPresharedKeyCsmKeyRef=PSK_11, TlsCsmBinderKeyRef=BinderKey_11_PSK_11
          TlsPskIdentity_2: TlsPresharedKeyIdentity=My_Secret_Password-2, TlsPresharedKeyCsmKeyRef=PSK_2, TlsCsmBinderKeyRef=BinderKey_2_PSK_2
          TlsPskIdentity_3: TlsPskGetClientKeyIdentityFunc=PSK_CBK3_TlsClientGetPskIdentity, TlsCsmBinderKeyRef=BinderKey_3_PSK_3
          TlsPskIdentity_4: TlsPskGetClientKeyIdentityFunc=PSK_CBK4_TlsClientGetPskIdentity, TlsCsmBinderKeyRef=BinderKey_4_PSK_4
          TlsPskIdentity_5: TlsPresharedKeyIdentity=My_Secret_Password-5, TlsPresharedKeyCsmKeyRef=PSK_5, TlsCsmBinderKeyRef=BinderKey_5_PSK_5
          TlsPskIdentity_6_server: TlsPresharedKeyIdentityHint=My_Secret_Password-0, TlsPresharedKeyCsmKeyRef=PSK_6, TlsCsmBinderKeyRef=BinderKey_6_PSK_6
          TlsPskIdentity_7_server: TlsPskGetKeyIdentityHintFunc=PSK_CBK1_TlsServerGetPskIdentityHint, TlsPskGetServerKeyIdentityFunc=PSK_CBK1_TlsServerGetPskIdentity, TlsCsmBinderKeyRef=BinderKey_7_PSK_7
          TlsPskIdentity_8_server: TlsPresharedKeyIdentityHint=My_Secret_Password-2, TlsPresharedKeyCsmKeyRef=PSK_8, TlsCsmBinderKeyRef=BinderKey_8_PSK_8
          TlsPskIdentity_9_server: TlsPskGetKeyIdentityHintFunc=PSK_CBK3_TlsServerGetPskIdentityHint, TlsPskGetServerKeyIdentityFunc=PSK_CBK3_TlsServerGetPskIdentity, TlsCsmBinderKeyRef=BinderKey_9_PSK_9
          TlsPskIdentity_6: TlsPresharedKeyIdentity=My_Secret_Password-66, TlsCsmBinderKeyRef=BinderKey_6_PSK_6, TlsPresharedKeyCsmKeyRef=PSK_6
        TlsCertificateIdentity_1 (TlsCertificateIdentity): TlsCipherKeyMLocalCertificate=KeyMCertificate_Server_0
      TlsConnectionGroup_0 (TlsConnectionGroup)
      TlsConnectionGroup_1 (TlsConnectionGroup)
      6 x TlsConnection, all with TlsUseExtensionCertificateStatusRequest=false, TlsUseExtensionMaxFragmentLength=false, TlsUseExtensionRecordSizeLimit=false, TlsUseExtensionTrustedCAKeys=false:
        TlsConnection_0: TlsConnectionType=TLS_CLIENT, TlsMaxFragmentLength=1, TlsMainFunctionPeriod=0.02, TlsWaitingTimeout=0.04, TlsConnectionCiphersuiteWorkerRef=TlsCiphersuiteWorker_0, TlsConnectionPskIdentityRef=TlsPskIdentity_1, TlsConnectionPskIdentityRef=TlsPskIdentity_0, TlsConnectionPskIdentityRef=TlsPskIdentity_2, TlsConnectionPskIdentityRef=TlsPskIdentity_3, TlsConnectionCiphersuiteWorkerRef=TlsCiphersuiteWorker_1, TlsConnectionCiphersuiteWorkerRef=TlsCiphersuiteWorker_2, TlsTcpConnectionRef=TcpIpTlsConnection_0, TlsConnectionGroupRef=TlsConnectionGroup_0, TlsCsmRandomGenerateJobRef=RandomGen_0
        TlsConnection_1: TlsConnectionType=TLS_CLIENT, TlsMaxFragmentLength=1, TlsMainFunctionPeriod=0.01, TlsWaitingTimeout=0.02, TlsConnectionCiphersuiteWorkerRef=TlsCiphersuiteWorker_1, TlsConnectionCiphersuiteWorkerRef=TlsCiphersuiteWorker_2, TlsTcpConnectionRef=TcpIpTlsConnection_1, TlsConnectionGroupRef=TlsConnectionGroup_0, TlsCsmRandomGenerateJobRef=RandomGen_1, TlsCertificateIdentityRef=TlsCertificateIdentity_0
        TlsConnection_2: TlsConnectionType=TLS_CLIENT, TlsMaxFragmentLength=1, TlsMainFunctionPeriod=0.01, TlsWaitingTimeout=0.03, TlsConnectionCiphersuiteWorkerRef=TlsCiphersuiteWorker_3, TlsConnectionPskIdentityRef=TlsPskIdentity_6, TlsTcpConnectionRef=TcpIpTlsConnection_2, TlsConnectionGroupRef=TlsConnectionGroup_1, TlsCsmRandomGenerateJobRef=RandomGen_2
        TlsConnection_3: TlsConnectionType=TLS_SERVER, TlsMaxFragmentLength=1, TlsMainFunctionPeriod=0.02, TlsWaitingTimeout=0.04, TlsConnectionCiphersuiteWorkerRef=TlsCiphersuiteWorker_0, TlsConnectionCiphersuiteWorkerRef=TlsCiphersuiteWorker_1, TlsConnectionCiphersuiteWorkerRef=TlsCiphersuiteWorker_2, TlsConnectionPskIdentityRef=TlsPskIdentity_6_server, TlsConnectionPskIdentityRef=TlsPskIdentity_7_server, TlsConnectionPskIdentityRef=TlsPskIdentity_8_server, TlsConnectionPskIdentityRef=TlsPskIdentity_9_server, TlsTcpConnectionRef=TcpIpTlsConnection_3, TlsConnectionGroupRef=TlsConnectionGroup_0, TlsCsmRandomGenerateJobRef=RandomGen_3
        TlsConnection_4: TlsConnectionType=TLS_SERVER, TlsMaxFragmentLength=1, TlsMainFunctionPeriod=0.01, TlsWaitingTimeout=0.05, TlsConnectionCiphersuiteWorkerRef=TlsCiphersuiteWorker_1, TlsConnectionCiphersuiteWorkerRef=TlsCiphersuiteWorker_2, TlsTcpConnectionRef=TcpIpTlsConnection_4, TlsConnectionGroupRef=TlsConnectionGroup_0, TlsCsmRandomGenerateJobRef=RandomGen_4, TlsCertificateIdentityRef=TlsCertificateIdentity_1
        TlsConnection_5: TlsConnectionType=TLS_SERVER, TlsMaxFragmentLength=100, TlsMainFunctionPeriod=0.06, TlsWaitingTimeout=0.6, TlsConnectionCiphersuiteWorkerRef=TlsCiphersuiteWorker_3, TlsConnectionPskIdentityRef=TlsPskIdentity_7_server, TlsTcpConnectionRef=TcpIpTlsConnection_5, TlsConnectionGroupRef=TlsConnectionGroup_1, TlsCsmRandomGenerateJobRef=RandomGen_5
    TlsGeneral_0 (TlsGeneral): TlsDevErrorDetect=true, TlsVersionInfoApi=true, TlsHandshakeTimeoutEnabled=true, TlsBufferLength=1000
  module config Csm_0: definition=Csm, ecuc-def-edition=4.9.0, implementation-config-variant=VARIANT-PRE-COMPILE
    CsmGeneral_0 (CsmGeneral): CsmDevErrorDetect=false, CsmVersionInfoApi=false
    CsmJobs_0 (CsmJobs)
      48 x CsmJob, all with CsmJobInterfaceUsePort=, CsmJobPriority=(unset), CsmProcessingMode=, CsmJobPrimitiveRef=(unset), CsmJobQueueRef=(unset):
        CipherCsmDecryptJob_0: CsmJobId=33, CsmJobKeyRef=CipherCsmDecryptKey_0
        CipherCsmDecryptJob_1: CsmJobId=34, CsmJobKeyRef=CipherCsmDecryptKey_1
        CipherCsmDecryptJob_2: CsmJobId=35, CsmJobKeyRef=CipherCsmDecryptKey_2
        CipherCsmDecryptJob_3: CsmJobId=36, CsmJobKeyRef=CipherCsmDecryptKey_3
        CipherCsmDecryptJob_4: CsmJobId=37, CsmJobKeyRef=CipherCsmDecryptKey_4
        CipherCsmEncryptJob_0: CsmJobId=28, CsmJobKeyRef=CipherCsmEncryptKey_0
        CipherCsmEncryptJob_1: CsmJobId=29, CsmJobKeyRef=CipherCsmEncryptKey_1
        CipherCsmEncryptJob_2: CsmJobId=30, CsmJobKeyRef=CipherCsmEncryptKey_2
        CipherCsmEncryptJob_3: CsmJobId=31, CsmJobKeyRef=CipherCsmEncryptKey_3
        CipherCsmEncryptJob_4: CsmJobId=32, CsmJobKeyRef=CipherCsmEncryptKey_4
        CipherCsmMacGenerateJob_0: CsmJobId=6, CsmJobKeyRef=CipherCsmMacGenerateKey_0
        CipherCsmMacGenerateJob_1: CsmJobId=12, CsmJobKeyRef=CipherCsmMacGenerateKey_1
        CipherCsmMacGenerateJob_2: CsmJobId=14, CsmJobKeyRef=CipherCsmMacGenerateKey_2
        CipherCsmMacGenerateJob_3: CsmJobId=16, CsmJobKeyRef=CipherCsmMacGenerateKey_2
        CipherCsmMacVerifyJob_0: CsmJobId=7, CsmJobKeyRef=CipherCsmMacVerifyKey_0
        CipherCsmMacVerifyJob_1: CsmJobId=13, CsmJobKeyRef=CipherCsmMacVerifyKey_1
        CipherCsmMacVerifyJob_2: CsmJobId=15, CsmJobKeyRef=CipherCsmMacGenerateKey_2
        CipherCsmMacVerifyJob_3: CsmJobId=17, CsmJobKeyRef=CipherCsmMacGenerateKey_2
        HKDFExpandJob_0: CsmJobId=4, CsmJobKeyRef=HKDFExpandKey_0
        HKDFExpandJob_1: CsmJobId=10, CsmJobKeyRef=HKDFExpandKey_1
        HKDFExpandJob_2: CsmJobId=19, CsmJobKeyRef=HKDFExpandKey_1
        HKDFExtractJob_0: CsmJobId=3, CsmJobKeyRef=HKDFExtractKey_0
        HKDFExtractJob_1: CsmJobId=9, CsmJobKeyRef=HKDFExtractKey_1
        HKDFExtractJob_2: CsmJobId=20, CsmJobKeyRef=HKDFExtractKey_1
        HashVerifyJob_0: CsmJobId=2, CsmJobKeyRef=(unset)
        HashVerifyJob_1: CsmJobId=8, CsmJobKeyRef=(unset)
        HashVerifyJob_2: CsmJobId=18, CsmJobKeyRef=(unset)
        PrfMacJob_0: CsmJobId=5, CsmJobKeyRef=PrfMacKey_0
        PrfMacJob_1: CsmJobId=11, CsmJobKeyRef=PrfMacKey_1
        PrfMacJob_2: CsmJobId=21, CsmJobKeyRef=PrfMacKey_1
        RandomGen_0: CsmJobId=1, CsmJobKeyRef=(unset)
        RandomGen_1: CsmJobId=2, CsmJobKeyRef=(unset)
        RandomGen_2: CsmJobId=3, CsmJobKeyRef=(unset)
        RandomGen_3: CsmJobId=4, CsmJobKeyRef=(unset)
        RandomGen_4: CsmJobId=5, CsmJobKeyRef=(unset)
        RandomGen_5: CsmJobId=5, CsmJobKeyRef=(unset)
        TlsCsmKeyExchangeCalcPubValJobRef_0: CsmJobId=37, CsmJobKeyRef=(unset)
        TlsCsmKeyExchangeCalcPubValJobRef_1: CsmJobId=38, CsmJobKeyRef=(unset)
        TlsCsmKeyExchangeCalcPubValJobRef_2: CsmJobId=39, CsmJobKeyRef=(unset)
        TlsCsmKeyExchangeCalcSecretJobRef_0: CsmJobId=40, CsmJobKeyRef=(unset)
        TlsCsmKeyExchangeCalcSecretJobRef_1: CsmJobId=41, CsmJobKeyRef=(unset)
        TlsCsmKeyExchangeCalcSecretJobRef_2: CsmJobId=43, CsmJobKeyRef=(unset)
        SigGenJob_0: CsmJobId=44, CsmJobKeyRef=(unset)
        SigGenJob_1: CsmJobId=45, CsmJobKeyRef=(unset)
        SigGenJob_2: CsmJobId=46, CsmJobKeyRef=(unset)
        SigVerifyJob_0: CsmJobId=47, CsmJobKeyRef=(unset)
        SigVerifyJob_1: CsmJobId=48, CsmJobKeyRef=(unset)
        SigVerifyJob_2: CsmJobId=49, CsmJobKeyRef=(unset)
          SigVerifyJob_2 (CsmJob):
            CsmJobId = 48
            CsmJobInterfaceUsePort = 
            CsmJobPriority = (unset)
            CsmProcessingMode = 
            CsmJobKeyRef = (unset)
            CsmJobPrimitiveRef = (unset)
            CsmJobQueueRef = (unset)
    CsmKeys_0 (CsmKeys)
      116 x CsmKey, all with CsmKeyUsePort=(unset), CsmKeyRef=(unset):
        BinderKey_0_PSK_0: CsmKeyId=1
        BinderKey_10_PSK_10: CsmKeyId=11
        BinderKey_11_PSK_11: CsmKeyId=12
        BinderKey_12_PSK_12: CsmKeyId=13
        BinderKey_1_PSK_1: CsmKeyId=2
        BinderKey_2_PSK_2: CsmKeyId=3
        BinderKey_3_PSK_3: CsmKeyId=4
        BinderKey_4_PSK_4: CsmKeyId=5
        BinderKey_5_PSK_5: CsmKeyId=6
        BinderKey_6_PSK_6: CsmKeyId=7
        BinderKey_7_PSK_7: CsmKeyId=8
        BinderKey_8_PSK_8: CsmKeyId=9
        BinderKey_9_PSK_9: CsmKeyId=10
        CipherCsmDecryptKey_0: CsmKeyId=14
        CipherCsmDecryptKey_1: CsmKeyId=15
        CipherCsmDecryptKey_2: CsmKeyId=16
        CipherCsmDecryptKey_3: CsmKeyId=17
        CipherCsmDecryptKey_4: CsmKeyId=18
        CipherCsmEncryptKey_0: CsmKeyId=19
        CipherCsmEncryptKey_1: CsmKeyId=20
        CipherCsmEncryptKey_2: CsmKeyId=21
        CipherCsmEncryptKey_3: CsmKeyId=22
        CipherCsmEncryptKey_4: CsmKeyId=23
        CipherCsmMacGenerateKey_0: CsmKeyId=24
        CipherCsmMacGenerateKey_1: CsmKeyId=25
        CipherCsmMacGenerateKey_2: CsmKeyId=26
        CipherCsmMacGenerateKey_3: CsmKeyId=27
        CipherCsmMacVerifyKey_0: CsmKeyId=28
        CipherCsmMacVerifyKey_1: CsmKeyId=29
        CipherCsmMacVerifyKey_2: CsmKeyId=30
        CipherCsmMacVerifyKey_3: CsmKeyId=31
        ClientApplicationTrafficSecretKey_0: CsmKeyId=32
        ClientApplicationTrafficSecretKey_1: CsmKeyId=33
        ClientApplicationTrafficSecretKey_2: CsmKeyId=34
        ClientApplicationTrafficSecretKey_3: CsmKeyId=35
        ClientApplicationWriteIV_0: CsmKeyId=36
        ClientApplicationWriteIV_1: CsmKeyId=37
        ClientApplicationWriteIV_2: CsmKeyId=38
        ClientApplicationWriteIV_3: CsmKeyId=39
        ClientApplicationWriteKey_0: CsmKeyId=40
        ClientApplicationWriteKey_1: CsmKeyId=41
        ClientApplicationWriteKey_2: CsmKeyId=42
        ClientApplicationWriteKey_3: CsmKeyId=43
        ClientHandshakeTrafficSecretKey_0: CsmKeyId=44
        ClientHandshakeTrafficSecretKey_1: CsmKeyId=45
        ClientHandshakeTrafficSecretKey_2: CsmKeyId=46
        ClientHandshakeWriteIV_0: CsmKeyId=47
        ClientHandshakeWriteIV_1: CsmKeyId=48
        ClientHandshakeWriteIV_2: CsmKeyId=49
        ClientHandshakeWritekey_0: CsmKeyId=50
        ClientHandshakeWritekey_1: CsmKeyId=51
        ClientHandshakeWritekey_2: CsmKeyId=52
        DerivedKey_0: CsmKeyId=53
        DerivedKey_1: CsmKeyId=54
        DerivedKey_2: CsmKeyId=55
        EarlySecretKey_0: CsmKeyId=56
        EarlySecretKey_1: CsmKeyId=57
        EarlySecretKey_2: CsmKeyId=58
        HKDFExpandKey_0: CsmKeyId=62
        HKDFExpandKey_1: CsmKeyId=63
        HKDFExpandKey_2: CsmKeyId=64
        HKDFExtractKey_0: CsmKeyId=65
        HKDFExtractKey_1: CsmKeyId=66
        HKDFExtractKey_2: CsmKeyId=67
        HandshakeSecretKey_0: CsmKeyId=59
        HandshakeSecretKey_1: CsmKeyId=60
        HandshakeSecretKey_2: CsmKeyId=61
        MasterKey_0: CsmKeyId=68
        MasterKey_1: CsmKeyId=69
        MasterKey_2: CsmKeyId=70
        PSK_0: CsmKeyId=74
        PSK_1: CsmKeyId=75
        PSK_10: CsmKeyId=84
        PSK_11: CsmKeyId=85
        PSK_12: CsmKeyId=86
        PSK_2: CsmKeyId=76
        PSK_3: CsmKeyId=77
        PSK_4: CsmKeyId=78
        PSK_5: CsmKeyId=79
        PSK_6: CsmKeyId=80
        PSK_7: CsmKeyId=81
        PSK_8: CsmKeyId=82
        PSK_9: CsmKeyId=83
        PrfMacKey_0: CsmKeyId=71
        PrfMacKey_1: CsmKeyId=72
        PrfMacKey_2: CsmKeyId=73
        ServerApplicationTrafficSecretKey_0: CsmKeyId=87
        ServerApplicationTrafficSecretKey_1: CsmKeyId=88
        ServerApplicationTrafficSecretKey_2: CsmKeyId=89
        ServerApplicationTrafficSecretKey_3: CsmKeyId=90
        ServerApplicationWriteIV_0: CsmKeyId=91
        ServerApplicationWriteIV_1: CsmKeyId=92
        ServerApplicationWriteIV_2: CsmKeyId=93
        ServerApplicationWriteIV_3: CsmKeyId=94
        ServerApplicationWriteKey_0: CsmKeyId=95
        ServerApplicationWriteKey_1: CsmKeyId=96
        ServerApplicationWriteKey_2: CsmKeyId=97
        ServerApplicationWriteKey_3: CsmKeyId=98
        ServerHandshakeTrafficSecretKey_0: CsmKeyId=99
        ServerHandshakeTrafficSecretKey_1: CsmKeyId=100
        ServerHandshakeTrafficSecretKey_2: CsmKeyId=101
        ServerHandshakeWriteIV_0: CsmKeyId=102
        ServerHandshakeWriteIV_1: CsmKeyId=103
        ServerHandshakeWriteIV_2: CsmKeyId=104
        ServerHandshakeWritekey_0: CsmKeyId=105
        ServerHandshakeWritekey_1: CsmKeyId=106
        ServerHandshakeWritekey_2: CsmKeyId=107
        TlsCsmKeyExchangeKeyRef_0: CsmKeyId=108
        TlsCsmKeyExchangeKeyRef_1: CsmKeyId=109
        TlsCsmKeyExchangeKeyRef_2: CsmKeyId=110
        SigGenKey_0: CsmKeyId=115
        SigGenKey_1: CsmKeyId=116
        SigGenKey_2: CsmKeyId=117
        SigVerifyKey_0: CsmKeyId=118
        SigVerifyKey_1: CsmKeyId=119
        SigVerifyKey_2: CsmKeyId=120
  module config KeyM_0: definition=KeyM, ecuc-def-edition=4.9.0, implementation-config-variant=VARIANT-PRE-COMPILE
    KeyMCertificate_Server_0 (KeyMCertificate):
      KeyMCertAlgorithmType = 
      KeyMCertFormatType = 
      KeyMCertificateId = 0
      KeyMCertificateMaxLength = 3000
      KeyMCertificateName = (unset)
      KeyMCertificateStorage = 
      KeyMCertUpperHierarchicalCertRef = (unset)
      KeyMCertificateElement_0 (KeyMCertificateElement):
        KeyMCertificateElementHasIteration = false
        KeyMCertificateElementId = 1
        KeyMCertificateElementMaxLength = (unset)
        KeyMCertificateElementOfStructure = CertificateSignatureAlgorithmID
      KeyMCertificateElement_1 (KeyMCertificateElement):
        KeyMCertificateElementHasIteration = false
        KeyMCertificateElementId = 2
        KeyMCertificateElementMaxLength = 512
        KeyMCertificateElementOfStructure = CertificateSubjectPublicKeyInfo_SubjectPublicKey
    KeyMGeneral_0 (KeyMGeneral):
      KeyMCertificateChainMaxDepth = (unset)
      KeyMCertificateManagerEnabled = false
      KeyMCryptoKeyHandlerPrepareEnabled = false
      KeyMCryptoKeyHandlerServiceCertificateEnabled = false
      KeyMCryptoKeyHandlerStartFinalizeEnabled = false
      KeyMCryptoKeyHandlerUpdateEnabled = false
      KeyMCryptoKeyHandlerVerifyEnabled = false
      KeyMCryptoKeyManagerEnabled = false
      KeyMDevErrorDetect = false
      KeyMEnableSecurityEventReporting = false
      KeyMKeyCertNameMaxLength = (unset)
      KeyMMainFunctionPeriod = (unset)
    KeyMCertificate_Server_1 (KeyMCertificate):
      KeyMCertAlgorithmType = 
      KeyMCertFormatType = 
      KeyMCertificateId = 1
      KeyMCertificateMaxLength = 4000
      KeyMCertificateName = (unset)
      KeyMCertificateStorage = 
      KeyMCertUpperHierarchicalCertRef = (unset)
      KeyMCertificateElement_0 (KeyMCertificateElement):
        KeyMCertificateElementHasIteration = false
        KeyMCertificateElementId = 1
        KeyMCertificateElementMaxLength = (unset)
        KeyMCertificateElementOfStructure = CertificateSignatureAlgorithmID
