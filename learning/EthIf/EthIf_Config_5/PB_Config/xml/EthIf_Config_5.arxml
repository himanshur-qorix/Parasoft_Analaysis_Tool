AUTOSAR XML (schema 00053)
package /ARRoot
  module config EcuC_0: definition=EcuC, ecuc-def-edition=4.6.0, implementation-config-variant=VARIANT-PRE-COMPILE
    EcucPartitionCollection_0 (EcucPartitionCollection)
    EcucPostBuildVariants_0 (EcucPostBuildVariants):
      EcucPostBuildVariantRef = PredefinedVariant_{0..3}
  module config EcuM_0: definition=EcuM, ecuc-def-edition=4.2.2, implementation-config-variant=VARIANT-PRE-COMPILE
    EcuMConfiguration_0 (EcuMConfiguration)
      EcuMCommonConfiguration_0 (EcuMCommonConfiguration): EcuMConfigConsistencyHash=(unset), EcuMDefaultAppMode=(unset), EcuMOSResource=(unset)
        EcuMDefaultShutdownTarget_0 (EcuMDefaultShutdownTarget): EcuMDefaultState=
        EcuMSleepMode_0 (EcuMSleepMode): EcuMSleepModeId=(unset), EcuMSleepModeSuspend=(unset), EcuMSleepModeMcuModeRef=(unset), EcuMWakeupSourceMask=(unset)
        EcuMWakeupSource_0 (EcuMWakeupSource): EcuMWakeupSourceId=1, EcuMWakeupSourcePolling=(unset)
    EcuMGeneral_0 (EcuMGeneral): EcuMDevErrorDetect=(unset), EcuMIncludeDet=(unset), EcuMMainFunctionPeriod=(unset), EcuMVersionInfoApi=(unset)
  module config EthIf_0: definition=EthIf, implementation-config-variant=VARIANT-POST-BUILD, module-description=EthIf_Impl, post-build-variant-used=true
    EthIfConfigSet_0 (EthIfConfigSet)
      4 x EthIfController, all with EthIfMaxTxBufsTotal=2, EthIfCtrlMtu=1500 if post-build-variant-conditions=[{matching-criterion=PostBuildVariantCriterion_0, value=0}, {matching-criterion=PostBuildVariantCriterion_1, value=0}], EthIfCtrlMtu=1501 if post-build-variant-conditions=[{matching-criterion=PostBuildVariantCriterion_0, value=0}, {matching-criterion=PostBuildVariantCriterion_1, value=1}], EthIfCtrlMtu=1502 if post-build-variant-conditions=[{matching-criterion=PostBuildVariantCriterion_0, value=1}, {matching-criterion=PostBuildVariantCriterion_1, value=0}], EthIfCtrlMtu=1503 if post-build-variant-conditions=[{matching-criterion=PostBuildVariantCriterion_0, value=1}, {matching-criterion=PostBuildVariantCriterion_1, value=1}], EthIfVlanId=2 if post-build-variant-conditions=[{matching-criterion=PostBuildVariantCriterion_0, value=0}, {matching-criterion=PostBuildVariantCriterion_1, value=0}], EthIfVlanId=3 if post-build-variant-conditions=[{matching-criterion=PostBuildVariantCriterion_0, value=0}, {matching-criterion=PostBuildVariantCriterion_1, value=1}], EthIfVlanId=4 if post-build-variant-conditions=[{matching-criterion=PostBuildVariantCriterion_0, value=1}, {matching-criterion=PostBuildVariantCriterion_1, value=0}], EthIfVlanId=5 if post-build-variant-conditions=[{matching-criterion=PostBuildVariantCriterion_0, value=1}, {matching-criterion=PostBuildVariantCriterion_1, value=1}], EthIfPhysControllerRef=EthIfPhysController_0 if post-build-variant-conditions=[{matching-criterion=PostBuildVariantCriterion_0, value=0}, {matching-criterion=PostBuildVariantCriterion_1, value=0}], EthIfEthTrcvRef=EthIfTransceiver_0 if post-build-variant-conditions=[{matching-criterion=PostBuildVariantCriterion_0, value=0}, {matching-criterion=PostBuildVariantCriterion_0, value=0}], EthIfEthTrcvRef=EthIfTransceiver_0 if post-build-variant-conditions=[{matching-criterion=PostBuildVariantCriterion_1, value=1}, {matching-criterion=PostBuildVariantCriterion_0, value=0}], EthIfEthTrcvRef=EthIfTransceiver_0 if post-build-variant-conditions=[{matching-criterion=PostBuildVariantCriterion_1, value=0}, {matching-criterion=PostBuildVariantCriterion_0, value=1}], EthIfEthTrcvRef=EthIfTransceiver_0 if post-build-variant-conditions=[{matching-criterion=PostBuildVariantCriterion_1, value=1}, {matching-criterion=PostBuildVariantCriterion_0, value=1}], EthIfPhysControllerRef=EthIfPhysController_0 if post-build-variant-conditions=[{matching-criterion=PostBuildVariantCriterion_0, value=0}, {matching-criterion=PostBuildVariantCriterion_1, value=1}], EthIfPhysControllerRef=EthIfPhysController_0 if post-build-variant-conditions=[{matching-criterion=PostBuildVariantCriterion_0, value=1}, {matching-criterion=PostBuildVariantCriterion_1, value=0}], EthIfPhysControllerRef=EthIfPhysController_0 if post-build-variant-conditions=[{matching-criterion=PostBuildVariantCriterion_0, value=1}, {matching-criterion=PostBuildVariantCriterion_1, value=1}], EthIfSwitchRefOrPortGroupRef=EthIfSwitch_0 if post-build-variant-conditions=[{matching-criterion=PostBuildVariantCriterion_0, value=0}, {matching-criterion=PostBuildVariantCriterion_1, value=0}], EthIfSwitchRefOrPortGroupRef=EthIfSwitch_0 if post-build-variant-conditions=[{matching-criterion=PostBuildVariantCriterion_0, value=0}, {matching-criterion=PostBuildVariantCriterion_1, value=1}], EthIfSwitchRefOrPortGroupRef=EthIfSwitch_0 if post-build-variant-conditions=[{matching-criterion=PostBuildVariantCriterion_0, value=1}, {matching-criterion=PostBuildVariantCriterion_1, value=0}], EthIfSwitchRefOrPortGroupRef=EthIfSwitch_0 if post-build-variant-conditions=[{matching-criterion=PostBuildVariantCriterion_0, value=1}, {matching-criterion=PostBuildVariantCriterion_1, value=1}]:
        EthIfController_0: EthIfCtrlIdx=0, EthIfMacSecSupport=NO_MACSEC if post-build-variant-conditions=[{matching-criterion=PostBuildVariantCriterion_1, value=0}, {matching-criterion=PostBuildVariantCriterion_0, value=0}], EthIfMacSecSupport=HW_MACSEC if post-build-variant-conditions=[{matching-criterion=PostBuildVariantCriterion_1, value=1}, {matching-criterion=PostBuildVariantCriterion_0, value=0}], EthIfMacSecSupport=SW_MACSEC if post-build-variant-conditions=[{matching-criterion=PostBuildVariantCriterion_1, value=0}, {matching-criterion=PostBuildVariantCriterion_0, value=1}], EthIfMacSecSupport=NO_MACSEC if post-build-variant-conditions=[{matching-criterion=PostBuildVariantCriterion_1, value=1}, {matching-criterion=PostBuildVariantCriterion_0, value=1}]
          EthIfController_0 (EthIfController):
            EthIfCtrlIdx = 0
            EthIfMaxTxBufsTotal = 2
            EthIfCtrlMtu = 1500 if post-build-variant-conditions=[{matching-criterion=PostBuildVariantCriterion_0, value=0}, {matching-criterion=PostBuildVariantCriterion_1, value=0}]
            EthIfCtrlMtu = 1501 if post-build-variant-conditions=[{matching-criterion=PostBuildVariantCriterion_0, value=0}, {matching-criterion=PostBuildVariantCriterion_1, value=1}]
            EthIfCtrlMtu = 1502 if post-build-variant-conditions=[{matching-criterion=PostBuildVariantCriterion_0, value=1}, {matching-criterion=PostBuildVariantCriterion_1, value=0}]
            EthIfCtrlMtu = 1503 if post-build-variant-conditions=[{matching-criterion=PostBuildVariantCriterion_0, value=1}, {matching-criterion=PostBuildVariantCriterion_1, value=1}]
            EthIfMacSecSupport = NO_MACSEC if post-build-variant-conditions=[{matching-criterion=PostBuildVariantCriterion_1, value=0}, {matching-criterion=PostBuildVariantCriterion_0, value=0}]
            EthIfMacSecSupport = NO_MACSEC if post-build-variant-conditions=[{matching-criterion=PostBuildVariantCriterion_1, value=1}, {matching-criterion=PostBuildVariantCriterion_0, value=0}]
            EthIfMacSecSupport = NO_MACSEC if post-build-variant-conditions=[{matching-criterion=PostBuildVariantCriterion_1, value=0}, {matching-criterion=PostBuildVariantCriterion_0, value=1}]
            EthIfMacSecSupport = NO_MACSEC if post-build-variant-conditions=[{matching-criterion=PostBuildVariantCriterion_1, value=1}, {matching-criterion=PostBuildVariantCriterion_0, value=1}]
            EthIfVlanId = 2 if post-build-variant-conditions=[{matching-criterion=PostBuildVariantCriterion_0, value=0}, {matching-criterion=PostBuildVariantCriterion_1, value=0}]
            EthIfVlanId = 3 if post-build-variant-conditions=[{matching-criterion=PostBuildVariantCriterion_0, value=0}, {matching-criterion=PostBuildVariantCriterion_1, value=1}]
            EthIfVlanId = 4 if post-build-variant-conditions=[{matching-criterion=PostBuildVariantCriterion_0, value=1}, {matching-criterion=PostBuildVariantCriterion_1, value=0}]
            EthIfVlanId = 5 if post-build-variant-conditions=[{matching-criterion=PostBuildVariantCriterion_0, value=1}, {matching-criterion=PostBuildVariantCriterion_1, value=1}]
            EthIfPhysControllerRef = EthIfPhysController_0 if post-build-variant-conditions=[{matching-criterion=PostBuildVariantCriterion_0, value=0}, {matching-criterion=PostBuildVariantCriterion_1, value=0}]
            EthIfEthTrcvRef = EthIfTransceiver_0 if post-build-variant-conditions=[{matching-criterion=PostBuildVariantCriterion_0, value=0}, {matching-criterion=PostBuildVariantCriterion_0, value=0}]
            EthIfEthTrcvRef = EthIfTransceiver_0 if post-build-variant-conditions=[{matching-criterion=PostBuildVariantCriterion_1, value=1}, {matching-criterion=PostBuildVariantCriterion_0, value=0}]
            EthIfEthTrcvRef = EthIfTransceiver_0 if post-build-variant-conditions=[{matching-criterion=PostBuildVariantCriterion_1, value=0}, {matching-criterion=PostBuildVariantCriterion_0, value=1}]
            EthIfEthTrcvRef = EthIfTransceiver_0 if post-build-variant-conditions=[{matching-criterion=PostBuildVariantCriterion_1, value=1}, {matching-criterion=PostBuildVariantCriterion_0, value=1}]
            EthIfPhysControllerRef = EthIfPhysController_0 if post-build-variant-conditions=[{matching-criterion=PostBuildVariantCriterion_0, value=0}, {matching-criterion=PostBuildVariantCriterion_1, value=1}]
            EthIfPhysControllerRef = EthIfPhysController_0 if post-build-variant-conditions=[{matching-criterion=PostBuildVariantCriterion_0, value=1}, {matching-criterion=PostBuildVariantCriterion_1, value=0}]
            EthIfPhysControllerRef = EthIfPhysController_0 if post-build-variant-conditions=[{matching-criterion=PostBuildVariantCriterion_0, value=1}, {matching-criterion=PostBuildVariantCriterion_1, value=1}]
            EthIfSwitchRefOrPortGroupRef = EthIfSwitch_0 if post-build-variant-conditions=[{matching-criterion=PostBuildVariantCriterion_0, value=0}, {matching-criterion=PostBuildVariantCriterion_1, value=0}]
            EthIfSwitchRefOrPortGroupRef = EthIfSwitch_0 if post-build-variant-conditions=[{matching-criterion=PostBuildVariantCriterion_0, value=0}, {matching-criterion=PostBuildVariantCriterion_1, value=1}]
            EthIfSwitchRefOrPortGroupRef = EthIfSwitch_0 if post-build-variant-conditions=[{matching-criterion=PostBuildVariantCriterion_0, value=1}, {matching-criterion=PostBuildVariantCriterion_1, value=0}]
            EthIfSwitchRefOrPortGroupRef = EthIfSwitch_0 if post-build-variant-conditions=[{matching-criterion=PostBuildVariantCriterion_0, value=1}, {matching-criterion=PostBuildVariantCriterion_1, value=1}]
        EthIfController_1: EthIfCtrlIdx=1, EthIfMacSecSupport=HW_MACSEC if post-build-variant-conditions=[{matching-criterion=PostBuildVariantCriterion_1, value=0}, {matching-criterion=PostBuildVariantCriterion_0, value=0}], EthIfMacSecSupport=NO_MACSEC if post-build-variant-conditions=[{matching-criterion=PostBuildVariantCriterion_1, value=1}, {matching-criterion=PostBuildVariantCriterion_0, value=0}], EthIfMacSecSupport=SW_MACSEC if post-build-variant-conditions=[{matching-criterion=PostBuildVariantCriterion_1, value=0}, {matching-criterion=PostBuildVariantCriterion_0, value=1}], EthIfMacSecSupport=NO_MACSEC if post-build-variant-conditions=[{matching-criterion=PostBuildVariantCriterion_1, value=1}, {matching-criterion=PostBuildVariantCriterion_0, value=1}]
        EthIfController_2: EthIfCtrlIdx=2, EthIfMacSecSupport=NO_MACSEC if post-build-variant-conditions=[{matching-criterion=PostBuildVariantCriterion_1, value=0}, {matching-criterion=PostBuildVariantCriterion_0, value=0}], EthIfMacSecSupport=HW_MACSEC if post-build-variant-conditions=[{matching-criterion=PostBuildVariantCriterion_1, value=1}, {matching-criterion=PostBuildVariantCriterion_0, value=0}], EthIfMacSecSupport=SW_MACSEC if post-build-variant-conditions=[{matching-criterion=PostBuildVariantCriterion_1, value=0}, {matching-criterion=PostBuildVariantCriterion_0, value=1}], EthIfMacSecSupport=NO_MACSEC if post-build-variant-conditions=[{matching-criterion=PostBuildVariantCriterion_1, value=1}, {matching-criterion=PostBuildVariantCriterion_0, value=1}]
        EthIfController_3: EthIfCtrlIdx=3, EthIfMacSecSupport=NO_MACSEC if post-build-variant-conditions=[{matching-criterion=PostBuildVariantCriterion_1, value=0}, {matching-criterion=PostBuildVariantCriterion_0, value=0}], EthIfMacSecSupport=HW_MACSEC if post-build-variant-conditions=[{matching-criterion=PostBuildVariantCriterion_1, value=1}, {matching-criterion=PostBuildVariantCriterion_0, value=0}], EthIfMacSecSupport=NO_MACSEC if post-build-variant-conditions=[{matching-criterion=PostBuildVariantCriterion_1, value=0}, {matching-criterion=PostBuildVariantCriterion_0, value=1}], EthIfMacSecSupport=SW_MACSEC if post-build-variant-conditions=[{matching-criterion=PostBuildVariantCriterion_1, value=1}, {matching-criterion=PostBuildVariantCriterion_0, value=1}]
      EthIfPhysController_0 (EthIfPhysController):
        EthIfPhysControllerIdx = 0
        EthIfEthCtrlRef = EthCtrlConfig_0 if post-build-variant-conditions=[{matching-criterion=PostBuildVariantCriterion_0, value=0}, {matching-criterion=PostBuildVariantCriterion_1, value=0}]
        EthIfEthCtrlRef = EthCtrlConfig_0 if post-build-variant-conditions=[{matching-criterion=PostBuildVariantCriterion_0, value=0}, {matching-criterion=PostBuildVariantCriterion_1, value=1}]
        EthIfEthCtrlRef = EthCtrlConfig_0 if post-build-variant-conditions=[{matching-criterion=PostBuildVariantCriterion_0, value=1}, {matching-criterion=PostBuildVariantCriterion_1, value=0}]
        EthIfEthCtrlRef = EthCtrlConfig_0 if post-build-variant-conditions=[{matching-criterion=PostBuildVariantCriterion_0, value=1}, {matching-criterion=PostBuildVariantCriterion_1, value=1}]
        EthIfClkUnit_0 (EthIfClkUnit): EthIfClkUnitIdx=0, EthIfClkUnitRef=EthClkUnit_0
      EthIfRxIndicationConfig_0 (EthIfRxIndicationConfig):
        EthIfRxIndicationFunction = TcpIp_RxIndication if post-build-variant-conditions=[{matching-criterion=PostBuildVariantCriterion_0, value=0}, {matching-criterion=PostBuildVariantCriterion_1, value=0}]
        EthIfRxIndicationFunction = TcpIp_RxIndication if post-build-variant-conditions=[{matching-criterion=PostBuildVariantCriterion_0, value=0}, {matching-criterion=PostBuildVariantCriterion_1, value=1}]
        EthIfRxIndicationFunction = TcpIp_RxIndication if post-build-variant-conditions=[{matching-criterion=PostBuildVariantCriterion_0, value=1}, {matching-criterion=PostBuildVariantCriterion_1, value=0}]
        EthIfRxIndicationFunction = TcpIp_RxIndication if post-build-variant-conditions=[{matching-criterion=PostBuildVariantCriterion_0, value=1}, {matching-criterion=PostBuildVariantCriterion_1, value=1}]
      EthIfRxIndicationConfig_1 (EthIfRxIndicationConfig):
        EthIfRxIndicationFunction = Cdd_EthIfRxIndication if post-build-variant-conditions=[{matching-criterion=PostBuildVariantCriterion_0, value=0}, {matching-criterion=PostBuildVariantCriterion_1, value=0}]
        EthIfRxIndicationFunction = Cdd_EthIfRxIndication if post-build-variant-conditions=[{matching-criterion=PostBuildVariantCriterion_0, value=0}, {matching-criterion=PostBuildVariantCriterion_1, value=1}]
        EthIfRxIndicationFunction = Cdd_EthIfRxIndication if post-build-variant-conditions=[{matching-criterion=PostBuildVariantCriterion_0, value=1}, {matching-criterion=PostBuildVariantCriterion_1, value=0}]
        EthIfRxIndicationFunction = Cdd_EthIfRxIndication if post-build-variant-conditions=[{matching-criterion=PostBuildVariantCriterion_0, value=1}, {matching-criterion=PostBuildVariantCriterion_1, value=1}]
      EthIfSwitchPortGroup_0 (EthIfSwitchPortGroup):
        EthIfSwitchPortGroupIdx = 0
        EthIfSwitchPortGroupRefSemantics = ETHIF_SWITCH_PORT_GROUP_CONTROL if post-build-variant-conditions=[{matching-criterion=PostBuildVariantCriterion_1, value=0}, {matching-criterion=PostBuildVariantCriterion_0, value=0}]
        EthIfSwitchPortGroupRefSemantics = ETHIF_SWITCH_PORT_GROUP_LINK_INFO if post-build-variant-conditions=[{matching-criterion=PostBuildVariantCriterion_1, value=1}, {matching-criterion=PostBuildVariantCriterion_0, value=0}]
        EthIfSwitchPortGroupRefSemantics = ETHIF_SWITCH_PORT_GROUP_CONTROL if post-build-variant-conditions=[{matching-criterion=PostBuildVariantCriterion_1, value=0}, {matching-criterion=PostBuildVariantCriterion_0, value=1}]
        EthIfSwitchPortGroupRefSemantics = ETHIF_SWITCH_PORT_GROUP_CONTROL if post-build-variant-conditions=[{matching-criterion=PostBuildVariantCriterion_1, value=1}, {matching-criterion=PostBuildVariantCriterion_0, value=1}]
        EthIfPortRef = EthSwtPort_0 if post-build-variant-conditions=[{matching-criterion=PostBuildVariantCriterion_0, value=0}, {matching-criterion=PostBuildVariantCriterion_1, value=0}]
        EthIfPortRef = EthSwtPort_0 if post-build-variant-conditions=[{matching-criterion=PostBuildVariantCriterion_0, value=0}, {matching-criterion=PostBuildVariantCriterion_1, value=1}]
        EthIfPortRef = EthSwtPort_0 if post-build-variant-conditions=[{matching-criterion=PostBuildVariantCriterion_0, value=1}, {matching-criterion=PostBuildVariantCriterion_1, value=0}]
        EthIfPortRef = EthSwtPort_0 if post-build-variant-conditions=[{matching-criterion=PostBuildVariantCriterion_0, value=1}, {matching-criterion=PostBuildVariantCriterion_1, value=1}]
      EthIfSwitch_0 (EthIfSwitch):
        EthIfSwitchIdx = 0
        EthIfSwitchRef = EthSwtConfig_0 if post-build-variant-conditions=[{matching-criterion=PostBuildVariantCriterion_0, value=0}, {matching-criterion=PostBuildVariantCriterion_1, value=0}]
        EthIfSwitchRef = EthSwtConfig_0 if post-build-variant-conditions=[{matching-criterion=PostBuildVariantCriterion_0, value=0}, {matching-criterion=PostBuildVariantCriterion_1, value=1}]
        EthIfSwitchRef = EthSwtConfig_0 if post-build-variant-conditions=[{matching-criterion=PostBuildVariantCriterion_0, value=1}, {matching-criterion=PostBuildVariantCriterion_1, value=0}]
        EthIfSwitchRef = EthSwtConfig_0 if post-build-variant-conditions=[{matching-criterion=PostBuildVariantCriterion_0, value=1}, {matching-criterion=PostBuildVariantCriterion_1, value=1}]
      EthIfTransceiver_0 (EthIfTransceiver):
        EthIfTransceiverIdx = 0
        EthIfEthTrcvRef = EthTrcvConfig_0 if post-build-variant-conditions=[{matching-criterion=PostBuildVariantCriterion_0, value=0}, {matching-criterion=PostBuildVariantCriterion_1, value=0}]
        EthIfEthTrcvRef = EthTrcvConfig_0 if post-build-variant-conditions=[{matching-criterion=PostBuildVariantCriterion_0, value=0}, {matching-criterion=PostBuildVariantCriterion_1, value=1}]
        EthIfEthTrcvRef = EthTrcvConfig_0 if post-build-variant-conditions=[{matching-criterion=PostBuildVariantCriterion_0, value=1}, {matching-criterion=PostBuildVariantCriterion_1, value=0}]
        EthIfEthTrcvRef = EthTrcvConfig_0 if post-build-variant-conditions=[{matching-criterion=PostBuildVariantCriterion_0, value=1}, {matching-criterion=PostBuildVariantCriterion_1, value=1}]
      EthIfTrcvLinkStateChgConfig_0 (EthIfTrcvLinkStateChgConfig):
        EthIfTrcvLinkStateChgFunction = Cdd_EthIfLinkStateChange if post-build-variant-conditions=[{matching-criterion=PostBuildVariantCriterion_0, value=0}, {matching-criterion=PostBuildVariantCriterion_1, value=0}]
        EthIfTrcvLinkStateChgFunction = Cdd_EthIfLinkStateChange if post-build-variant-conditions=[{matching-criterion=PostBuildVariantCriterion_0, value=0}, {matching-criterion=PostBuildVariantCriterion_1, value=1}]
        EthIfTrcvLinkStateChgFunction = Cdd_EthIfLinkStateChange if post-build-variant-conditions=[{matching-criterion=PostBuildVariantCriterion_0, value=1}, {matching-criterion=PostBuildVariantCriterion_1, value=0}]
        EthIfTrcvLinkStateChgFunction = Cdd_EthIfLinkStateChange if post-build-variant-conditions=[{matching-criterion=PostBuildVariantCriterion_0, value=1}, {matching-criterion=PostBuildVariantCriterion_1, value=1}]
      EthIfTxConfirmationConfig_0 (EthIfTxConfirmationConfig):
        EthIfTxConfirmationFunction = Cdd_EthIfTxConfirmation if post-build-variant-conditions=[{matching-criterion=PostBuildVariantCriterion_0, value=0}, {matching-criterion=PostBuildVariantCriterion_1, value=0}]
        EthIfTxConfirmationFunction = Cdd_EthIfTxConfirmation if post-build-variant-conditions=[{matching-criterion=PostBuildVariantCriterion_0, value=0}, {matching-criterion=PostBuildVariantCriterion_1, value=1}]
        EthIfTxConfirmationFunction = Cdd_EthIfTxConfirmation if post-build-variant-conditions=[{matching-criterion=PostBuildVariantCriterion_0, value=1}, {matching-criterion=PostBuildVariantCriterion_1, value=0}]
        EthIfTxConfirmationFunction = Cdd_EthIfTxConfirmation if post-build-variant-conditions=[{matching-criterion=PostBuildVariantCriterion_0, value=1}, {matching-criterion=PostBuildVariantCriterion_1, value=1}]
      EthIfFrameConfig_0 (EthIfFrameConfig):
        EthIfFrameType = 2048 if post-build-variant-conditions=[{matching-criterion=PostBuildVariantCriterion_0, value=0}, {matching-criterion=PostBuildVariantCriterion_1, value=0}]
        EthIfOwner = 0 if post-build-variant-conditions=[{matching-criterion=PostBuildVariantCriterion_0, value=0}, {matching-criterion=PostBuildVariantCriterion_1, value=0}]
        EthIfFrameType = 2050 if post-build-variant-conditions=[{matching-criterion=PostBuildVariantCriterion_0, value=0}, {matching-criterion=PostBuildVariantCriterion_1, value=1}]
        EthIfFrameType = 2051 if post-build-variant-conditions=[{matching-criterion=PostBuildVariantCriterion_0, value=1}, {matching-criterion=PostBuildVariantCriterion_1, value=0}]
        EthIfFrameType = 2052 if post-build-variant-conditions=[{matching-criterion=PostBuildVariantCriterion_0, value=1}, {matching-criterion=PostBuildVariantCriterion_1, value=1}]
        EthIfOwner = 2 if post-build-variant-conditions=[{matching-criterion=PostBuildVariantCriterion_0, value=0}, {matching-criterion=PostBuildVariantCriterion_1, value=1}]
        EthIfOwner = 3 if post-build-variant-conditions=[{matching-criterion=PostBuildVariantCriterion_0, value=1}, {matching-criterion=PostBuildVariantCriterion_1, value=0}]
        EthIfOwner = 4 if post-build-variant-conditions=[{matching-criterion=PostBuildVariantCriterion_0, value=1}, {matching-criterion=PostBuildVariantCriterion_1, value=1}]
      EthIfFrameConfig_1 (EthIfFrameConfig):
        EthIfFrameType = 2049 if post-build-variant-conditions=[{matching-criterion=PostBuildVariantCriterion_0, value=0}, {matching-criterion=PostBuildVariantCriterion_1, value=0}]
        EthIfOwner = 1 if post-build-variant-conditions=[{matching-criterion=PostBuildVariantCriterion_0, value=0}, {matching-criterion=PostBuildVariantCriterion_1, value=0}]
        EthIfFrameType = 2053 if post-build-variant-conditions=[{matching-criterion=PostBuildVariantCriterion_0, value=0}, {matching-criterion=PostBuildVariantCriterion_1, value=1}]
        EthIfFrameType = 2054 if post-build-variant-conditions=[{matching-criterion=PostBuildVariantCriterion_0, value=1}, {matching-criterion=PostBuildVariantCriterion_1, value=0}]
        EthIfFrameType = 2055 if post-build-variant-conditions=[{matching-criterion=PostBuildVariantCriterion_0, value=1}, {matching-criterion=PostBuildVariantCriterion_1, value=1}]
        EthIfOwner = 7 if post-build-variant-conditions=[{matching-criterion=PostBuildVariantCriterion_0, value=0}, {matching-criterion=PostBuildVariantCriterion_1, value=1}]
        EthIfOwner = 5 if post-build-variant-conditions=[{matching-criterion=PostBuildVariantCriterion_0, value=1}, {matching-criterion=PostBuildVariantCriterion_1, value=0}]
        EthIfOwner = 6 if post-build-variant-conditions=[{matching-criterion=PostBuildVariantCriterion_0, value=1}, {matching-criterion=PostBuildVariantCriterion_1, value=1}]
    EthIfGeneral_0 (EthIfGeneral):
      EthIfDevErrorDetect = true
      EthIfEnableRxInterrupt = false
      EthIfEnableTxInterrupt = true
      EthIfGetBaudRate = true
      EthIfGetCounterState = true
      EthIfGlobalTimeSupport = true
      EthIfMainFunctionPeriod = 0.005
      EthIfMaxTrcvsTotal = 1
      EthIfRxIndicationIterations = 5
      EthIfStartAutoNegotiation = true
      EthIfTrcvLinkStateChgMainReload = 2
      EthIfVersionInfoApi = true
      EthIfVersionInfoApiMacro = false
      EthIfWakeUpSupport = true
      EthIfPublicCddHeaderFile = Cdd
      EthIfEnableSecurityEventReporting = false
      EthIfEnableSignalQualityApi = false
      EthIfEnableWEthApi = false
      EthIfGetAndResetMeasurementDataApi = false
      EthIfVerifyConfigApi = false
      EthIfSwitchManagementSupport = false
      EthIfSetForwardingModeApi = false
      EthIfGetVlanIdSupport = true
      EthIfGetCtrlIdxList = true
      EthIfFwSupport = NO_FIREWALL
      EthIfPhcSupport = false
  module config EthSwt_0: definition=EthSwt
    EthSwtConfig_0 (EthSwtConfig): EthSwtIdx=0
      EthSwtPort_0 (EthSwtPort): EthSwtPortEnableLinkDownCallback=, EthSwtPortIdx=, EthSwtPortPhysicalLayerType=
        EthSwtPortEgress_0 (EthSwtPortEgress): EthSwtPortEgressLastSchedulerRef=(unset)
          EthSwtPortFifo_0 (EthSwtPortFifo)
          EthSwtPortScheduler_0 (EthSwtPortScheduler): EthSwtPortSchedulerAlgorithm=
            EthSwtPortSchedulerPredecessor_0 (EthSwtPortSchedulerPredecessor): EthSwtPortSchedulerPredecessorOrder=, EthSwtPortEgressPredecessorRef=(unset)
        EthSwtPortIngress_0 (EthSwtPortIngress)
    EthSwtGeneral_0 (EthSwtGeneral):
      EthSwtDevErrorDetect = 
      EthSwtEnableVlanApi = 
      EthSwtGetArlTableApi = true
      EthSwtGetBufferLevelApi = true
      EthSwtGetDropCountApi = true
      EthSwtGetEtherStatsApi = 
      EthSwtGetMacLearningModeApi = 
      EthSwtGetPortMacAddrApi = true
      EthSwtGetSwitchRegApi = 
      EthSwtIndex = 
      EthSwtPersistentConfigurationResult = 
      EthSwtReadTrcvRegisterApi = 
      EthSwtResetConfigurationApi = true
      EthSwtSetMacLearningModeApi = 
      EthSwtSetSwitchRegApi = 
      EthSwtStoreConfigurationApi = true
      EthSwtVersionInfoApi = 
      EthSwtWriteTrcvRegisterApi = 
  module config EthTrcv_0: definition=EthTrcv, ecuc-def-edition=4.2.2, implementation-config-variant=VARIANT-PRE-COMPILE, module-description=EthTrcv_Impl
    EthTrcvConfigSet_0 (EthTrcvConfigSet)
      EthTrcvConfig_0 (EthTrcvConfig): EthTrcvAutoNegotiationEnabled=(unset), EthTrcvConnNeg=, EthTrcvCtrlIdx=0, EthTrcvDuplexMode=, EthTrcvIdx=0, EthTrcvMiiIdx=(unset), EthTrcvSpeed=
        EthTrcvWakeupMap_0 (EthTrcvWakeupMap): EthTrcvWakeupReason=ETHTRCV_WUR_BUS, EthTrcvWakeupSourceRef=EcuMWakeupSource_0
    EthTrcvGeneral_0 (EthTrcvGeneral):
      EthTrcvDevErrorDetect = (unset)
      EthTrcvGetBaudRateApi = (unset)
      EthTrcvGetDuplexModeApi = (unset)
      EthTrcvGetLinkStateApi = (unset)
      EthTrcvGetTransceiverModeApi = (unset)
      EthTrcvIndex = (unset)
      EthTrcvMaxTrcvsSupported = 1
      EthTrcvSetTransceiverModeApi = (unset)
      EthTrcvStartAutoNegotiationApi = (unset)
      EthTrcvVersionInfoApi = (unset)
      EthTrcvVersionInfoApiMacro = (unset)
      EthTrcvWakeUpSupport = ETHTRCV_WAKEUP_BY_INTERRUPT
  module config Eth_0: definition=Eth
    EthConfigSet_0 (EthConfigSet)
      EthCtrlConfig_0 (EthCtrlConfig):
        EthCtrlEnableMii = 
        EthCtrlEnableRxInterrupt = 
        EthCtrlEnableTxInterrupt = 
        EthCtrlIdx = 0
        EthCtrlRxBufLenByte = 
        EthCtrlTxBufLenByte = 
        EthRxBufTotal = 
        EthTxBufTotal = 
        EthClkUnit_0 (EthClkUnit): EthClkUnitCrossTimestampingSupport=NO_XTIMESTAMPING, EthClkUnitIdx=0, EthClkUnitTimeStampingRef=(unset)
    EthGeneral_0 (EthGeneral):
      EthDevErrorDetect = 
      EthGetDropCountApi = 
      EthGetEtherStatsApi = 
      EthGlobalTimeSupport = 
      EthIndex = 
      EthMainFunctionPeriod = 
      EthMaxCtrlsSupported = 
      EthUpdatePhysAddrFilter = false
      EthVersionInfoApi = 
      EthCtrlOffloading_0 (EthCtrlOffloading): EthCtrlEnableOffloadChecksumICMP=, EthCtrlEnableOffloadChecksumIPv4=, EthCtrlEnableOffloadChecksumTCP=, EthCtrlEnableOffloadChecksumUDP=
  module config Mka_0: definition=Mka, ecuc-def-edition=4.9.0, implementation-config-variant=VARIANT-PRE-COMPILE
    MkaCryptoAlgoConfig_0 (MkaCryptoAlgoConfig): MkaCryptoAlgoConfigIdx=(unset), MkaMacSecCapability=INTEGRITY_WITHOUT_CONFIDENTIALITY, MkaMacSecReplayProtection=false
      MkaCipherSuites_0 (MkaCipherSuites): MkaMacSecCipherSuite=GCM_AES_128, MkaMacSecCipherSuitePrio=(unset)
    MkaGeneral_0 (MkaGeneral):
      MkaDevErrorDetect = false
      MkaEnableSecurityEventReporting = false
      MkaHelloTime = 2
      MkaLifeTime = 6
      MkaMainFunctionPeriod = (unset)
      MkaSakRetireTime = 3
      MkaVersionInfoApi = false
    MkaPaeConfiguration_0 (MkaPaeConfiguration): MkaAutoStart=true, MkaPaeConfigurationIdx=(unset), MkaRetryBaseDelay=(unset), MkaRetryCyclicDelay=(unset), MkaSakRekeyTimeSpan=(unset)
    MkaPaeInstance_0 (MkaPaeInstance): MkaOnFailPermissiveMode=, MkaOnFailPermissiveModeTimeout=255, MkaPaeIdx=(unset), MkaEthIfControllerRef=(unset), MkaPaeConfRef=(unset)
      MkaKay_0 (MkaKay): MkaDstMacAddress=(unset), MkaRole=, MkaSrcMacAddress=(unset)
        MkaKayDemEventParameterRefs_0 (MkaKayDemEventParameterRefs)
        MkaKayParticipant_0 (MkaKayParticipant):
          MkaParticipantActivate = false
          MkaCryptoAlgoRef = (unset)
          MkaCryptoCknCakKeyRef = (unset)
          MkaCryptoIckDeriveJobRef = (unset)
          MkaCryptoIcvGenerateJobRef = (unset)
          MkaCryptoIcvVerifyJobRef = (unset)
          MkaCryptoKekDeriveJobRef = (unset)
          MkaCryptoKeyUnwrapJobRef = (unset)
          MkaCryptoKeyWrapJobRef = (unset)
          MkaCryptoRandomJobRef = (unset)
          MkaCryptoSakKeyRef = (unset)
