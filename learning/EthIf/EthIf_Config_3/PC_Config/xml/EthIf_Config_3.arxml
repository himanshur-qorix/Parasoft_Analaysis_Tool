AUTOSAR XML (schema 00053)
package /ARRoot
  module config EcuM_0: definition=EcuM, ecuc-def-edition=4.10.0, implementation-config-variant=VARIANT-PRE-COMPILE
    EcuMConfiguration_0 (EcuMConfiguration)
      EcuMCommonConfiguration_0 (EcuMCommonConfiguration): EcuMIgnoreWakeupEvValOffPreOS=false, EcuMDefaultAppMode=(unset), EcuMOSResource=(unset)
        EcuMDefaultShutdownTarget_0 (EcuMDefaultShutdownTarget): EcuMDefaultShutdownTarget=, EcuMDefaultResetModeRef=(unset), EcuMDefaultSleepModeRef=(unset)
        EcuMSleepMode_0 (EcuMSleepMode): EcuMSleepModeId=(unset), EcuMSleepModeSuspend=(unset), EcuMSleepModeMcuModeRef=(unset), EcuMWakeupSourceMask=(unset)
        EcuMWakeupSource_0 (EcuMWakeupSource): EcuMWakeupSourceId=0, EcuMWakeupSourcePolling=(unset)
    EcuMGeneral_0 (EcuMGeneral): EcuMDevErrorDetect=false, EcuMMainFunctionPeriod=(unset), EcuMVersionInfoApi=false
  module config EthIf_0: definition=EthIf, implementation-config-variant=VARIANT-PRE-COMPILE, module-description=EthIf_Impl
    EthIfConfigSet_0 (EthIfConfigSet)
      8 x EthIfController, all with EthIfCtrlMtu=1500, EthIfMaxTxBufsTotal=10:
        EthIfController_0: EthIfCtrlIdx=0, EthIfVlanId=2, EthIfEthTrcvRef=EthIfTransceiver_0, EthIfPhysControllerRef=EthIfPhysController_0
        EthIfController_1: EthIfCtrlIdx=1, EthIfMacSecSupport=SW_MACSEC, EthIfPhysControllerRef=EthIfPhysController_0, EthIfPaeInstanceRef=MkaPaeInstance_0
          EthIfICVHandler_0 (EthIfICVHandler): EthIfCryptoICKKeyRef=CsmKey_0, EthIfCryptoIcvGenerateJobRef=CsmJob_0, EthIfCryptoIcvVerifyJobRef=CsmJob_2
        EthIfController_2: EthIfCtrlIdx=2, EthIfVlanId=2, EthIfPhysControllerRef=EthIfPhysController_0
        EthIfController_3: EthIfCtrlIdx=3, EthIfVlanId=7, EthIfPhysControllerRef=EthIfPhysController_0
        EthIfController_4: EthIfCtrlIdx=4, EthIfVlanId=8, EthIfPhysControllerRef=EthIfPhysController_1
        EthIfController_5: EthIfCtrlIdx=5, EthIfVlanId=9, EthIfPhysControllerRef=EthIfPhysController_1
        EthIfController_6: EthIfCtrlIdx=6, EthIfVlanId=500, EthIfPhysControllerRef=EthIfPhysController_1
        EthIfController_7: EthIfCtrlIdx=7, EthIfPhysControllerRef=EthIfPhysController_1
      EthIfFrameConfig_0 (EthIfFrameConfig): EthIfFrameType=2048, EthIfOwner=0
        EthIfFrameTxPool_0 (EthIfFrameTxPool): EthIfFrameTxControllerRef=EthIfController_0
          EthIfFrameTxPdu_0 (EthIfFrameTxPdu): EthIfFrameTxPduId=0, EthIfFrameTxPduRef=Pdu_0
      EthIfFrameConfig_1 (EthIfFrameConfig): EthIfFrameType=35063, EthIfOwner=1
      EthIfPhysController_0 (EthIfPhysController): EthIfPhysControllerIdx=0, EthIfEthCtrlRef=EthCtrlConfig_0
        EthIfClkUnit_0 (EthIfClkUnit): EthIfClkUnitIdx=0, EthIfClkUnitRef=EthCtrlConfig_0/EthClkUnit_0
      EthIfPhysController_1 (EthIfPhysController): EthIfPhysControllerIdx=1, EthIfEthCtrlRef=EthCtrlConfig_1
        EthIfClkUnit_0 (EthIfClkUnit): EthIfClkUnitIdx=0, EthIfClkUnitRef=EthCtrlConfig_1/EthClkUnit_0
      EthIfRxIndicationConfig_0 (EthIfRxIndicationConfig): EthIfRxIndicationFunction=LSduR_EthIfRxIndication
      EthIfRxIndicationConfig_1 (EthIfRxIndicationConfig): EthIfRxIndicationFunction=TcpIp_RxIndication
      EthIfSwitch_0 (EthIfSwitch): EthIfSwitchIdx=0, EthIfSwitchRef=EthSwtConfig_0
      EthIfTransceiver_0 (EthIfTransceiver): EthIfTransceiverIdx=0, EthIfEthTrcvRef=EthTrcvConfig_0
      EthIfTransceiver_1 (EthIfTransceiver): EthIfTransceiverIdx=1, EthIfEthTrcvRef=EthTrcvConfig_0
      EthIfTrcvLinkStateChgConfig_0 (EthIfTrcvLinkStateChgConfig): EthIfTrcvLinkStateChgFunction=Cdd_EthIfLinkStateChange
      EthIfTrcvLinkStateChgConfig_1 (EthIfTrcvLinkStateChgConfig): EthIfTrcvLinkStateChgFunction=Mka_LinkStateChange
      EthIfTxConfirmationConfig_0 (EthIfTxConfirmationConfig): EthIfTxConfirmationFunction=Cdd_EthIfTxConfirmation
      EthIfTxConfirmationConfig_1 (EthIfTxConfirmationConfig): EthIfTxConfirmationFunction=EthTSyn_TxConfirmation
    EthIfGeneral_0 (EthIfGeneral):
      EthIfDevErrorDetect = true
      EthIfEnableRxInterrupt = false
      EthIfEnableTxInterrupt = false
      EthIfGetBaudRate = true
      EthIfGetCounterState = true
      EthIfGlobalTimeSupport = true
      EthIfMainFunctionPeriod = 0.005
      EthIfMaxTrcvsTotal = 1
      EthIfRxIndicationIterations = 5
      EthIfStartAutoNegotiation = true
      EthIfTrcvLinkStateChgMainReload = 2
      EthIfVersionInfoApi = true
      EthIfVersionInfoApiMacro = false
      EthIfWakeUpSupport = true
      EthIfPublicCddHeaderFile = Cdd
      EthIfEnableSecurityEventReporting = false
      EthIfEnableSignalQualityApi = false
      EthIfGetAndResetMeasurementDataApi = false
      EthIfGetCtrlIdxList = false
      EthIfGetVlanIdSupport = false
      EthIfSwitchManagementSupport = false
      EthIfVerifyConfigApi = false
      EthIfSetForwardingModeApi = false
      EthIfFwSupport = NO_FIREWALL
      EthIfPhcSupport = false
  module config EthSwt_0: definition=EthSwt
    EthSwtConfig_0 (EthSwtConfig): EthSwtIdx=0
      EthSwtPort_0 (EthSwtPort): EthSwtPortEnableLinkDownCallback=, EthSwtPortIdx=, EthSwtPortPhysicalLayerType=
        EthSwtPortEgress_0 (EthSwtPortEgress): EthSwtPortEgressLastSchedulerRef=(unset)
          EthSwtPortFifo_0 (EthSwtPortFifo)
          EthSwtPortScheduler_0 (EthSwtPortScheduler): EthSwtPortSchedulerAlgorithm=
            EthSwtPortSchedulerPredecessor_0 (EthSwtPortSchedulerPredecessor): EthSwtPortSchedulerPredecessorOrder=, EthSwtPortEgressPredecessorRef=(unset)
        EthSwtPortIngress_0 (EthSwtPortIngress)
    EthSwtGeneral_0 (EthSwtGeneral):
      EthSwtDevErrorDetect = 
      EthSwtEnableVlanApi = 
      EthSwtGetArlTableApi = 
      EthSwtGetBufferLevelApi = 
      EthSwtGetDropCountApi = 
      EthSwtGetEtherStatsApi = 
      EthSwtGetMacLearningModeApi = 
      EthSwtGetPortMacAddrApi = 
      EthSwtGetSwitchRegApi = 
      EthSwtIndex = 
      EthSwtPersistentConfigurationResult = 
      EthSwtReadTrcvRegisterApi = 
      EthSwtResetConfigurationApi = 
      EthSwtSetMacLearningModeApi = 
      EthSwtSetSwitchRegApi = 
      EthSwtStoreConfigurationApi = 
      EthSwtVersionInfoApi = 
      EthSwtWriteTrcvRegisterApi = 
  module config EthTrcv_0: definition=EthTrcv, ecuc-def-edition=4.2.2, implementation-config-variant=VARIANT-PRE-COMPILE, module-description=EthTrcv_Impl
    EthTrcvConfigSet_0 (EthTrcvConfigSet)
      EthTrcvConfig_0 (EthTrcvConfig): EthTrcvAutoNegotiationEnabled=(unset), EthTrcvConnNeg=, EthTrcvCtrlIdx=0, EthTrcvDuplexMode=, EthTrcvIdx=0, EthTrcvMiiIdx=(unset), EthTrcvSpeed=
        EthTrcvWakeupMap_0 (EthTrcvWakeupMap): EthTrcvWakeupReason=ETHTRCV_WUR_BUS, EthTrcvWakeupSourceRef=EcuMWakeupSource_0
    EthTrcvGeneral_0 (EthTrcvGeneral):
      EthTrcvDevErrorDetect = (unset)
      EthTrcvGetBaudRateApi = (unset)
      EthTrcvGetDuplexModeApi = (unset)
      EthTrcvGetLinkStateApi = (unset)
      EthTrcvGetTransceiverModeApi = (unset)
      EthTrcvIndex = (unset)
      EthTrcvMaxTrcvsSupported = 1
      EthTrcvSetTransceiverModeApi = (unset)
      EthTrcvStartAutoNegotiationApi = (unset)
      EthTrcvVersionInfoApi = (unset)
      EthTrcvVersionInfoApiMacro = (unset)
      EthTrcvWakeUpSupport = ETHTRCV_WAKEUP_BY_POLLING
  module config Eth_0: definition=Eth, module-description=Eth_39_DriverA_Impl
    EthConfigSet_0 (EthConfigSet)
      EthCtrlConfig_0 (EthCtrlConfig):
        EthCtrlEnableMii = 
        EthCtrlEnableRxInterrupt = 
        EthCtrlEnableTxInterrupt = 
        EthCtrlIdx = 0
        EthCtrlRxBufLenByte = 
        EthCtrlTxBufLenByte = 
        EthRxBufTotal = 
        EthTxBufTotal = 
        EthCtrlEnableEgressHardwareSupportedDataTransfer = false
        EthClkUnit_0 (EthClkUnit): EthClkUnitCrossTimestampingSupport=NO_XTIMESTAMPING, EthClkUnitIdx=0, EthClkUnitTimeStampingRef=(unset)
    EthGeneral_0 (EthGeneral):
      EthDevErrorDetect = 
      EthGetDropCountApi = 
      EthGetEtherStatsApi = 
      EthGlobalTimeSupport = 
      EthIndex = 
      EthMainFunctionPeriod = 
      EthMaxCtrlsSupported = 
      EthUpdatePhysAddrFilter = false
      EthVersionInfoApi = 
      EthCtrlOffloading_0 (EthCtrlOffloading): EthCtrlEnableOffloadChecksumICMP=, EthCtrlEnableOffloadChecksumIPv4=, EthCtrlEnableOffloadChecksumTCP=, EthCtrlEnableOffloadChecksumUDP=
  module config Eth_1: definition=Eth, ecuc-def-edition=4.10.0, implementation-config-variant=VARIANT-PRE-COMPILE, module-description=Eth_39_DriverB_Impl
    EthConfigSet_0 (EthConfigSet)
      EthCtrlConfig_1 (EthCtrlConfig):
        EthCtrlEnableMii = 
        EthCtrlEnableRxInterrupt = 
        EthCtrlEnableTxInterrupt = 
        EthCtrlIdx = 1
        EthCtrlRxBufLenByte = 
        EthCtrlTxBufLenByte = 
        EthRxBufTotal = 
        EthTxBufTotal = 
        EthCtrlEnableEgressHardwareSupportedDataTransfer = false
        EthClkUnit_0 (EthClkUnit): EthClkUnitCrossTimestampingSupport=NO_XTIMESTAMPING, EthClkUnitIdx=0, EthClkUnitTimeStampingRef=(unset)
    EthGeneral_0 (EthGeneral):
      EthDevErrorDetect = false
      EthGetCounterValuesApi = (unset)
      EthGetRxStatsApi = false
      EthGetTxErrorCounterValuesApi = false
      EthGetTxStatsApi = false
      EthGlobalTimeSupport = (unset)
      EthIndex = (unset)
      EthMainFunctionPeriod = (unset)
      EthPhcSupport = (unset)
      EthVersionInfoApi = false
      EthCtrlOffloading_0 (EthCtrlOffloading):
        EthCtrlEnableOffloadChecksumICMP = (unset)
        EthCtrlEnableOffloadChecksumIPv4 = (unset)
        EthCtrlEnableOffloadChecksumTCP = (unset)
        EthCtrlEnableOffloadChecksumUDP = (unset)
  module config Mka_0: definition=Mka, ecuc-def-edition=4.10.0, implementation-config-variant=VARIANT-PRE-COMPILE
    MkaCryptoAlgoConfig_0 (MkaCryptoAlgoConfig): MkaCryptoAlgoConfigIdx=(unset), MkaMacSecCapability=INTEGRITY_WITHOUT_CONFIDENTIALITY, MkaMacSecReplayProtection=false
      MkaCipherSuites_0 (MkaCipherSuites): MkaMacSecCipherSuite=GCM_AES_128, MkaMacSecCipherSuitePrio=(unset)
    MkaGeneral_0 (MkaGeneral):
      MkaDevErrorDetect = false
      MkaEnableSecurityEventReporting = false
      MkaHelloTime = 2
      MkaLifeTime = 6
      MkaMainFunctionPeriod = (unset)
      MkaSakRetireTime = 3
      MkaVersionInfoApi = false
    MkaPaeConfiguration_0 (MkaPaeConfiguration): MkaAutoStart=true, MkaPaeConfigurationIdx=(unset), MkaRetryBaseDelay=(unset), MkaRetryCyclicDelay=(unset), MkaSakRekeyTimeSpan=(unset)
    MkaPaeInstance_0 (MkaPaeInstance): MkaOnFailPermissiveMode=, MkaOnFailPermissiveModeTimeout=255, MkaPaeIdx=0, MkaEthIfControllerRef=(unset), MkaPaeConfRef=(unset)
      MkaKay_0 (MkaKay): MkaDstMacAddress=(unset), MkaRole=, MkaSrcMacAddress=(unset)
        MkaKayDemEventParameterRefs_0 (MkaKayDemEventParameterRefs)
        MkaKayParticipant_0 (MkaKayParticipant):
          MkaParticipantActivate = false
          MkaCryptoAlgoRef = (unset)
          MkaCryptoCknCakKeyRef = (unset)
          MkaCryptoIckDeriveJobRef = (unset)
          MkaCryptoIcvGenerateJobRef = (unset)
          MkaCryptoIcvVerifyJobRef = (unset)
          MkaCryptoKekDeriveJobRef = (unset)
          MkaCryptoKeyUnwrapJobRef = (unset)
          MkaCryptoKeyWrapJobRef = (unset)
          MkaCryptoRandomJobRef = (unset)
          MkaCryptoSakKeyRef = (unset)
      MkaPaeRxPdu_0 (MkaPaeRxPdu): MkaPaeRxPduId=(unset), MkaPaeRxPduRef=(unset)
      MkaPaeTxPdu_0 (MkaPaeTxPdu): MkaPaeTxPduId=(unset), MkaPaeTxPduRef=(unset)
  module config EcuC_0: definition=EcuC, ecuc-def-edition=4.10.0, implementation-config-variant=VARIANT-PRE-COMPILE
    EcucHardware_0 (EcucHardware)
      EcucCoreDefinition_0 (EcucCoreDefinition): EcucCoreId=(unset)
    EcucConfigSet_0 (EcucConfigSet)
      EcucPduCollection_0 (EcucPduCollection): PduIdTypeEnum=, PduLengthTypeEnum=
        Pdu_0 (Pdu): PduLength=12
  module config LSduR_0: definition=LSduR, ecuc-def-edition=4.10.0, implementation-config-variant=VARIANT-PRE-COMPILE, module-description=LSDUR_Impl
    LSduRConfig_0 (LSduRConfig): LSduRConfigurationId=(unset)
      LSduRPath_0 (LSduRPath)
        LSduRPathDestinationPdu_0 (LSduRPathDestinationPdu): LSduRPathDestinationPduId=0, LSduRPathDestinationPduRef=Pdu_0
        LSduRPathSourcePdu_0 (LSduRPathSourcePdu): LSduRPathSourcePduRef=(unset)
    LSduRGeneral_0 (LSduRGeneral): LSduRDevErrorDetect=false, LSduRMetaDataSupport=(unset), LSduRVersionInfoApi=false, LSduRZeroCostOperation=(unset)
  module config Csm_0: definition=Csm, ecuc-def-edition=4.10.0, implementation-config-variant=VARIANT-PRE-COMPILE
    CsmGeneral_0 (CsmGeneral): CsmDevErrorDetect=false, CsmVersionInfoApi=false
    CsmJobs_0 (CsmJobs)
      3 x CsmJob, all with CsmJobInterfaceUsePort=, CsmJobPriority=(unset), CsmProcessingMode=, CsmJobKeyRef=(unset), CsmJobPrimitiveRef=(unset), CsmJobQueueRef=(unset):
        CsmJob_0: CsmJobId=0
        CsmJob_1: CsmJobId=1
        CsmJob_2: CsmJobId=5
    CsmKeys_0 (CsmKeys)
      CsmKey_0 (CsmKey): CsmKeyId=2, CsmKeyUsePort=(unset), CsmKeyRef=(unset)
