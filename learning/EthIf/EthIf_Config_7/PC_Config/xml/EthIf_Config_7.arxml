AUTOSAR XML (schema 00053)
package /ARRoot
  module config EthIf_0: definition=EthIf, implementation-config-variant=VARIANT-PRE-COMPILE, module-description=EthIf_Impl
    EthIfConfigSet_0 (EthIfConfigSet)
      4 x EthIfController, all with EthIfCtrlMtu=1500, EthIfMaxTxBufsTotal=10, EthIfPhysControllerRef=EthIfPhysController_0:
        EthIfController_0: EthIfCtrlIdx=0, EthIfEthTrcvRef=EthIfTransceiver_0
        EthIfController_{1..3}: EthIfCtrlIdx={1..3}
      EthIfPhysController_0 (EthIfPhysController): EthIfPhysControllerIdx=0, EthIfEthCtrlRef=EthCtrlConfig_0
        EthIfClkUnit_0 (EthIfClkUnit): EthIfClkUnitIdx=0, EthIfClkUnitRef=EthCtrlConfig_0/EthClkUnit_0
      EthIfRxIndicationConfig_0 (EthIfRxIndicationConfig): EthIfRxIndicationFunction=LSduR_EthIfRxIndication
      EthIfRxIndicationConfig_1 (EthIfRxIndicationConfig): EthIfRxIndicationFunction=TcpIp_RxIndication
      EthIfSwitch_0 (EthIfSwitch): EthIfSwitchIdx=0, EthIfSwitchRef=EthSwt_0/EthSwtConfig_0
      EthIfTransceiver_0 (EthIfTransceiver): EthIfTransceiverIdx=0, EthIfEthTrcvRef=EthTrcvConfig_0
      EthIfTrcvLinkStateChgConfig_0 (EthIfTrcvLinkStateChgConfig): EthIfTrcvLinkStateChgFunction=Cdd_EthIfLinkStateChange
      EthIfTxConfirmationConfig_0 (EthIfTxConfirmationConfig): EthIfTxConfirmationFunction=Cdd_EthIfTxConfirmation
      EthIfFrameConfig_0 (EthIfFrameConfig): EthIfFrameType=2048, EthIfOwner=0
        EthIfFrameTxPool_0 (EthIfFrameTxPool): EthIfFrameTxControllerRef=EthIfController_0
          EthIfFrameTxPdu_0 (EthIfFrameTxPdu): EthIfFrameTxPduId=0, EthIfFrameTxPduRef=Pdu_0
        EthIfFrameRxPool_0 (EthIfFrameRxPool): EthIfFrameRxControllerRef=EthIfController_0
          EthIfFrameRxPdu_0 (EthIfFrameRxPdu): EthIfFrameRxPduId=0, EthIfFrameRxPduRef=Pdu_1
      EthIfFrameConfig_1 (EthIfFrameConfig): EthIfFrameType=35063, EthIfOwner=1
      EthIfSwitch_1 (EthIfSwitch): EthIfSwitchIdx=1, EthIfSwitchRef=EthSwt_1/EthSwtConfig_0
    EthIfGeneral_0 (EthIfGeneral):
      EthIfDevErrorDetect = true
      EthIfEnableRxInterrupt = false
      EthIfEnableTxInterrupt = true
      EthIfGetBaudRate = true
      EthIfGetCounterState = true
      EthIfGlobalTimeSupport = true
      EthIfMainFunctionPeriod = 0.005
      EthIfMaxTrcvsTotal = 1
      EthIfRxIndicationIterations = 5
      EthIfStartAutoNegotiation = true
      EthIfTrcvLinkStateChgMainReload = 2
      EthIfVersionInfoApi = true
      EthIfVersionInfoApiMacro = false
      EthIfWakeUpSupport = true
      EthIfPublicCddHeaderFile = Cdd
      EthIfEnableSecurityEventReporting = true
      EthIfEnableSignalQualityApi = false
      EthIfGetAndResetMeasurementDataApi = true
      EthIfGetCtrlIdxList = false
      EthIfGetVlanIdSupport = false
      EthIfSwitchManagementSupport = false
      EthIfVerifyConfigApi = false
      EthIfSetForwardingModeApi = false
      EthIfFwSupport = NO_FIREWALL
      EthIfPhcSupport = false
      EthIfEnableWEthApi = true
      EthIfSecurityEventRefs_0 (EthIfSecurityEventRefs):
        SEV_ETH_DROP_UNKNOWN_ETHERTYPE = IdsMEvent_0
        SEV_ETH_DROP_INV_VLAN = IdsMEvent_0
        SEV_ETH_DROP_MAC_COLLISION = IdsMEvent_0
        SEV_ETH_DROP_VLAN_DOUBLE_TAG = IdsMEvent_0
  module config EthSwt_0: definition=EthSwt, module-description=EthSwt_39_DriverA_Impl
    EthSwtConfig_0 (EthSwtConfig): EthSwtIdx=0
      EthSwtPort_0 (EthSwtPort): EthSwtPortEnableLinkDownCallback=, EthSwtPortIdx=, EthSwtPortPhysicalLayerType=
        EthSwtPortEgress_0 (EthSwtPortEgress): EthSwtPortEgressLastSchedulerRef=(unset)
          EthSwtPortFifo_0 (EthSwtPortFifo)
          EthSwtPortScheduler_0 (EthSwtPortScheduler): EthSwtPortSchedulerAlgorithm=
            EthSwtPortSchedulerPredecessor_0 (EthSwtPortSchedulerPredecessor): EthSwtPortSchedulerPredecessorOrder=, EthSwtPortEgressPredecessorRef=(unset)
        EthSwtPortIngress_0 (EthSwtPortIngress)
    EthSwtGeneral_0 (EthSwtGeneral):
      EthSwtDevErrorDetect = 
      EthSwtEnableVlanApi = 
      EthSwtGetArlTableApi = true
      EthSwtGetBufferLevelApi = 
      EthSwtGetDropCountApi = 
      EthSwtGetEtherStatsApi = 
      EthSwtGetMacLearningModeApi = 
      EthSwtGetPortMacAddrApi = true
      EthSwtGetSwitchRegApi = 
      EthSwtIndex = 
      EthSwtPersistentConfigurationResult = 
      EthSwtReadTrcvRegisterApi = 
      EthSwtResetConfigurationApi = true
      EthSwtSetMacLearningModeApi = 
      EthSwtSetSwitchRegApi = 
      EthSwtStoreConfigurationApi = true
      EthSwtVersionInfoApi = 
      EthSwtWriteTrcvRegisterApi = 
  module config EthTrcv_0: definition=EthTrcv, ecuc-def-edition=4.2.2, implementation-config-variant=VARIANT-PRE-COMPILE, module-description=EthTrcv_Impl
    EthTrcvConfigSet_0 (EthTrcvConfigSet)
      EthTrcvConfig_0 (EthTrcvConfig): EthTrcvAutoNegotiationEnabled=(unset), EthTrcvConnNeg=, EthTrcvCtrlIdx=0, EthTrcvDuplexMode=, EthTrcvIdx=0, EthTrcvMiiIdx=(unset), EthTrcvSpeed=
        EthTrcvWakeupMap_0 (EthTrcvWakeupMap): EthTrcvWakeupReason=ETHTRCV_WUR_BUS, EthTrcvWakeupSourceRef=EcuMWakeupSource_0
        EthTrcvWakeupMap_1 (EthTrcvWakeupMap): EthTrcvWakeupReason=ETHTRCV_WUR_BUS, EthTrcvWakeupSourceRef=EcuMWakeupSource_0
    EthTrcvGeneral_0 (EthTrcvGeneral):
      EthTrcvDevErrorDetect = (unset)
      EthTrcvGetBaudRateApi = (unset)
      EthTrcvGetDuplexModeApi = (unset)
      EthTrcvGetLinkStateApi = (unset)
      EthTrcvGetTransceiverModeApi = (unset)
      EthTrcvIndex = (unset)
      EthTrcvMaxTrcvsSupported = 1
      EthTrcvSetTransceiverModeApi = (unset)
      EthTrcvStartAutoNegotiationApi = (unset)
      EthTrcvVersionInfoApi = (unset)
      EthTrcvVersionInfoApiMacro = (unset)
      EthTrcvWakeUpSupport = ETHTRCV_WAKEUP_BY_POLLING
  module config Eth_0: definition=Eth
    EthConfigSet_0 (EthConfigSet)
      EthCtrlConfig_0 (EthCtrlConfig):
        EthCtrlEnableMii = 
        EthCtrlEnableRxInterrupt = 
        EthCtrlEnableTxInterrupt = 
        EthCtrlIdx = 0
        EthCtrlRxBufLenByte = 
        EthCtrlTxBufLenByte = 
        EthRxBufTotal = 
        EthTxBufTotal = 
        EthCtrlEnableEgressHardwareSupportedDataTransfer = false
        EthClkUnit_0 (EthClkUnit): EthClkUnitCrossTimestampingSupport=NO_XTIMESTAMPING, EthClkUnitIdx=0, EthClkUnitTimeStampingRef=(unset)
      EthCtrlConfig_1 (EthCtrlConfig):
        EthCtrlEnableMii = 
        EthCtrlEnableRxInterrupt = 
        EthCtrlEnableTxInterrupt = 
        EthCtrlIdx = 1
        EthCtrlRxBufLenByte = 
        EthCtrlTxBufLenByte = 
        EthRxBufTotal = 
        EthTxBufTotal = 
        EthCtrlEnableEgressHardwareSupportedDataTransfer = true
        EthClkUnit_0 (EthClkUnit): EthClkUnitCrossTimestampingSupport=NO_XTIMESTAMPING, EthClkUnitIdx=0, EthClkUnitTimeStampingRef=(unset)
        EthCtrlConfigEgress_0 (EthCtrlConfigEgress): EthCtrlConfigEgressLastSchedulerRef=(unset)
          EthCtrlConfigEgressQueue_0 (EthCtrlConfigEgressQueue): index=0, EthCtrlConfigEgressQueueBufLenByte=(unset), EthCtrlConfigEgressQueueBufTotal=(unset), EthCtrlConfigEgressQueueIdx=0
            EthCtrlConfigEgressQueueTransmissionSelection_0 (EthCtrlConfigEgressQueueTransmissionSelection): EthCtrlConfigEgressQueueTransmissionSelectionAlgorithm=ETH_TRANSMISSION_SELECTION_UNSHAPED
          EthCtrlConfigScheduler_0 (EthCtrlConfigScheduler): EthCtrlConfigSchedulerAlgorithm=
            EthCtrlConfigSchedulerPredecessor_0 (EthCtrlConfigSchedulerPredecessor): EthCtrlConfigSchedulerPredecessorOrder=(unset), EthCtrlConfigSchedulerPredecessorRef=(unset)
    EthGeneral_0 (EthGeneral):
      EthDevErrorDetect = 
      EthGetDropCountApi = 
      EthGetEtherStatsApi = 
      EthGlobalTimeSupport = 
      EthIndex = 
      EthMainFunctionPeriod = 
      EthMaxCtrlsSupported = 
      EthUpdatePhysAddrFilter = false
      EthVersionInfoApi = 
      EthCtrlOffloading_0 (EthCtrlOffloading): EthCtrlEnableOffloadChecksumICMP=, EthCtrlEnableOffloadChecksumIPv4=, EthCtrlEnableOffloadChecksumTCP=, EthCtrlEnableOffloadChecksumUDP=
  module config EcuM_0: definition=EcuM, ecuc-def-edition=4.10.0, implementation-config-variant=VARIANT-PRE-COMPILE
    EcuMConfiguration_0 (EcuMConfiguration)
      EcuMCommonConfiguration_0 (EcuMCommonConfiguration): EcuMIgnoreWakeupEvValOffPreOS=false, EcuMDefaultAppMode=(unset), EcuMOSResource=(unset)
        EcuMDefaultShutdownTarget_0 (EcuMDefaultShutdownTarget): EcuMDefaultShutdownTarget=, EcuMDefaultResetModeRef=(unset), EcuMDefaultSleepModeRef=(unset)
        EcuMSleepMode_0 (EcuMSleepMode): EcuMSleepModeId=(unset), EcuMSleepModeSuspend=(unset), EcuMSleepModeMcuModeRef=(unset), EcuMWakeupSourceMask=(unset)
        EcuMWakeupSource_0 (EcuMWakeupSource): EcuMWakeupSourceId=0, EcuMWakeupSourcePolling=true
    EcuMGeneral_0 (EcuMGeneral): EcuMDevErrorDetect=false, EcuMMainFunctionPeriod=(unset), EcuMVersionInfoApi=false
  module config LSduR_0: definition=LSduR, ecuc-def-edition=4.10.0, implementation-config-variant=VARIANT-PRE-COMPILE, module-description=LSDUR_Impl
    LSduRConfig_0 (LSduRConfig): LSduRConfigurationId=(unset)
      LSduRPath_0 (LSduRPath)
        LSduRPathDestinationPdu_0 (LSduRPathDestinationPdu): LSduRPathDestinationPduId=0, LSduRPathDestinationPduRef=Pdu_0
        LSduRPathSourcePdu_0 (LSduRPathSourcePdu): LSduRPathSourcePduRef=(unset)
      LSduRPath_1 (LSduRPath)
        LSduRPathDestinationPdu_0 (LSduRPathDestinationPdu): LSduRPathDestinationPduRef=(unset)
        LSduRPathSourcePdu_0 (LSduRPathSourcePdu): LSduRPathSourcePduId=0, LSduRPathSourcePduRef=Pdu_1
    LSduRGeneral_0 (LSduRGeneral): LSduRDevErrorDetect=false, LSduRMetaDataSupport=(unset), LSduRVersionInfoApi=false, LSduRZeroCostOperation=(unset)
  module config EcuC_0: definition=EcuC, ecuc-def-edition=4.10.0, implementation-config-variant=VARIANT-PRE-COMPILE
    EcucHardware_0 (EcucHardware)
      EcucCoreDefinition_0 (EcucCoreDefinition): EcucCoreId=(unset)
    EcucConfigSet_0 (EcucConfigSet)
      EcucPduCollection_0 (EcucPduCollection): PduIdTypeEnum=, PduLengthTypeEnum=
        Pdu_0 (Pdu): PduLength=12, MetaDataTypeRef=MetaDataType_0
        Pdu_1 (Pdu): PduLength=12, KeepLocalPduBuffer=true, MetaDataTypeRef=MetaDataType_0
        MetaDataType_0 (MetaDataType)
          MetaDataItem_0 (MetaDataItem): index=0, MetaDataItemLength=8, MetaDataItemType=ETHERNET_MAC_64
  module config IdsM_0: definition=IdsM, ecuc-def-edition=4.10.0, implementation-config-variant=VARIANT-PRE-COMPILE
    IdsMConfiguration_0 (IdsMConfiguration)
      IdsMBufferConfiguration_0 (IdsMBufferConfiguration): IdsMEventDisplacementStrategy=
        IdsMEventBuffers_0 (IdsMEventBuffers): IdsMNumberOfEventBuffers=(unset)
        IdsMQualifiedEventBuffers_0 (IdsMQualifiedEventBuffers): IdsMNumberOfQualifiedEventBuffers=(unset)
      IdsMEvent_0 (IdsMEvent): IdsMExternalEventId=(unset), IdsMInternalEventId=65535, IdsMReportingModeFilter=, IdsMSensorInstanceId=0, IdsMSinkDem=false, IdsMSinkIdsR=false
    IdsMGeneral_0 (IdsMGeneral):
      IdsMDevErrorDetect = (unset)
      IdsMDiagnosticSupport = false
      IdsMEnableSecurityEventReporting = false
      IdsMInstanceId = (unset)
      IdsMMainFunctionPeriod = 0.01
      IdsMSignatureSupport = false
      IdsMTimestampSupport = false
      IdsMVersionInfoApi = (unset)
  module config EthSwt_1: definition=EthSwt, ecuc-def-edition=4.10.0, implementation-config-variant=VARIANT-PRE-COMPILE, module-description=EthSwt_39_DriverB_Impl
    EthSwtConfig_0 (EthSwtConfig):
      EthSwtClockSynchronizationSupport = false
      EthSwtDropDoubleTagged = false
      EthSwtIdx = 1
      EthSwtMacAddressLearningMode = SVL
      EthSwtUsedInternalPriorityUpperValue = 7
      EthSwtUsedTrafficClassUpperValue = 7
      EthSwtPort_0 (EthSwtPort): EthSwtFramePreemptionEnable=false, EthSwtPortIdx=(unset), EthSwtPortTimeStampSupport=(unset)
        EthSwtPortEgress_0 (EthSwtPortEgress): EthSwtPortDefaultTrafficClass=1, EthSwtPortEgressLastSchedulerRef=(unset)
          EthSwtPortEgressScheduler_0 (EthSwtPortEgressScheduler): EthSwtPortSchedulerAlgorithm=
            EthSwtPortEgressSchedulerPredecessor_0 (EthSwtPortEgressSchedulerPredecessor): EthSwtPortSchedulerPredecessorOrder=(unset), EthSwtPortEgressPredecessorRef=(unset)
          EthSwtPortFifo_0 (EthSwtPortFifo): EthSwtPortEgressFifoIdx=(unset)
          EthSwtPortPriorityToTrafficClassAssignment_0 (EthSwtPortPriorityToTrafficClassAssignment): EthSwtPortPriorityToTrafficClassAssignmentPriority=(unset), EthSwtPortPriorityToTrafficClassAssignmentTrafficClass=(unset)
          EthSwtPortQueue_0 (EthSwtPortQueue):
            EthSwtPortEgressQueueIdx = (unset)
            EthSwtPortQueueTrafficClassAssignment = (unset)
            EthSwtTrafficClassToPreemptionStatusAssignment = ETHSWT_TRAFFIC_CLASS_EXPRESS
            EthSwtPortEgressQueueTransmissionSelection_0 (EthSwtPortEgressQueueTransmissionSelection): EthSwtPortEgressQueueTransmissionSelectionAlgorithm=ETHSWT_TRANSMISSION_SELECTION_ALGORITHM_UNSHAPED
        EthSwtPortIngress_0 (EthSwtPortIngress): EthSwtPortIngressDropUntagged=false
          EthSwtPortIngressVlanTranslationTable_0 (EthSwtPortIngressVlanTranslationTable)
          8 x EthSwtPortPriorityRegeneration, all with EthSwtPortPriorityRegenerationIngressPCP=(unset), EthSwtPortPriorityRegenerationRegeneratedPriority=(unset):
            EthSwtPortPriorityRegeneration_{0..7}
      EthSwtUnknownMacDestAddressConfig_0 (EthSwtUnknownMacDestAddressConfig)
    EthSwtGeneral_0 (EthSwtGeneral):
      EthSwtCheckWakeupApi = (unset)
      EthSwtDeletePortMirrorConfigurationApi = (unset)
      EthSwtDevErrorDetect = false
      EthSwtEnableCableDiagnosticApi = (unset)
      EthSwtEnableVlanApi = (unset)
      EthSwtGetArlTableApi = (unset)
      EthSwtGetBaudRateApi = (unset)
      EthSwtGetCfgRaw = (unset)
      EthSwtGetCounterValuesApi = (unset)
      EthSwtGetDuplexModeApi = (unset)
      EthSwtGetLinkStateApi = (unset)
      EthSwtGetMacLearningModeApi = (unset)
      EthSwtGetMaxQueueBufferFillLevelApi = (unset)
      EthSwtGetPortCableDiagnosticsResultApi = (unset)
      EthSwtGetPortIdentifierApi = (unset)
      EthSwtGetPortMacAddrApi = (unset)
      EthSwtGetPortMirrorStateApi = (unset)
      EthSwtGetPortSignalQualityApi = (unset)
      EthSwtGetRxStatsApi = (unset)
      EthSwtGetSwitchIdentifierApi = (unset)
      EthSwtGetSwitchPortModeApi = (unset)
      EthSwtGetSwitchPortWakeupReasonApi = (unset)
      EthSwtGetSwitchRegApi = (unset)
      EthSwtGetTxErrorCounterValuesApi = false
      EthSwtGetTxStatsApi = false
      EthSwtGlobalTimeSupportApi = (unset)
      EthSwtIndex = (unset)
      EthSwtMainFunctionPeriod = (unset)
      EthSwtManagementSupportApi = (unset)
      EthSwtPersistentConfigurationResult = (unset)
      EthSwtReadMmdApi = false
      EthSwtReadPortMirrorConfigurationApi = (unset)
      EthSwtReadTrcvRegisterApi = (unset)
      EthSwtResetConfigurationApi = (unset)
      EthSwtSetForwardingModeApi = false
      EthSwtSetMacLearningModeApi = (unset)
      EthSwtSetPortLoopbackModeApi = (unset)
      EthSwtSetPortMirrorStateApi = (unset)
      EthSwtSetPortTestModeApi = (unset)
      EthSwtSetPortTxModeApi = (unset)
      EthSwtSetSwitchPortModeApi = (unset)
      EthSwtSetSwitchRegApi = (unset)
      EthSwtStartSwitchPortAutoNegotiationApi = (unset)
      EthSwtStoreConfigurationApi = (unset)
      EthSwtVerifyConfigApi = false
      EthSwtVersionInfoApi = false
      EthSwtWriteMmdApi = false
      EthSwtWritePortMirrorConfigurationApi = (unset)
      EthSwtWriteTrcvRegisterApi = (unset)
