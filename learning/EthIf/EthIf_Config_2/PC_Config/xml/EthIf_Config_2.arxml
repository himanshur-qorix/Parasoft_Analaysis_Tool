AUTOSAR XML (schema 00053)
package /ARRoot
  module config EthIf_0: definition=EthIf, implementation-config-variant=VARIANT-PRE-COMPILE, module-description=EthIf_Impl
    EthIfConfigSet_0 (EthIfConfigSet)
      8 x EthIfController, all with EthIfCtrlMtu=1500, EthIfMaxTxBufsTotal=10:
        EthIfController_0: EthIfCtrlIdx=0, EthIfVlanId=2, EthIfEthTrcvRef=EthIfTransceiver_0, EthIfPhysControllerRef=EthIfPhysController_0
        EthIfController_1: EthIfCtrlIdx=1, EthIfPhysControllerRef=EthIfPhysController_1
        EthIfController_2: EthIfCtrlIdx=2, EthIfVlanId=6, EthIfPhysControllerRef=EthIfPhysController_0
        EthIfController_3: EthIfCtrlIdx=3, EthIfVlanId=7, EthIfPhysControllerRef=EthIfPhysController_0
        EthIfController_4: EthIfCtrlIdx=4, EthIfVlanId=8, EthIfPhysControllerRef=EthIfPhysController_1
        EthIfController_5: EthIfCtrlIdx=5, EthIfVlanId=9, EthIfPhysControllerRef=EthIfPhysController_1
        EthIfController_6: EthIfCtrlIdx=6, EthIfVlanId=500, EthIfPhysControllerRef=EthIfPhysController_1
        EthIfController_7: EthIfCtrlIdx=7, EthIfPhysControllerRef=EthIfPhysController_1
      EthIfFrameConfig_0 (EthIfFrameConfig): EthIfFrameType=2048, EthIfOwner=0
        EthIfFrameTxPool_0 (EthIfFrameTxPool): EthIfFrameTxControllerRef=EthIfController_0
          EthIfFrameTxPdu_0 (EthIfFrameTxPdu): EthIfFrameTxPduId=0, EthIfFrameTxPduRef=Pdu_0
          EthIfFrameTxPdu_1 (EthIfFrameTxPdu): EthIfFrameTxPduId=1, EthIfFrameTxPduRef=Pdu_1
        EthIfFrameTxPool_1 (EthIfFrameTxPool): EthIfFrameTxControllerRef=EthIfController_1
          EthIfFrameTxPdu_2 (EthIfFrameTxPdu): EthIfFrameTxPduId=2, EthIfFrameTxPduRef=Pdu_2
      EthIfFrameConfig_1 (EthIfFrameConfig): EthIfFrameType=35063, EthIfOwner=1
      EthIfPhysController_0 (EthIfPhysController): EthIfPhysControllerIdx=0, EthIfEthCtrlRef=EthCtrlConfig_0
        EthIfClkUnit_0 (EthIfClkUnit): EthIfClkUnitIdx=0, EthIfClkUnitRef=EthCtrlConfig_0/EthClkUnit_0
      EthIfPhysController_1 (EthIfPhysController): EthIfPhysControllerIdx=1, EthIfEthCtrlRef=EthCtrlConfig_1
        EthIfClkUnit_0 (EthIfClkUnit): EthIfClkUnitIdx=0, EthIfClkUnitRef=EthCtrlConfig_1/EthClkUnit_0
      EthIfRxIndicationConfig_0 (EthIfRxIndicationConfig): EthIfRxIndicationFunction=TcpIp_RxIndication
      EthIfRxIndicationConfig_1 (EthIfRxIndicationConfig): EthIfRxIndicationFunction=TcpIp_RxIndication
      EthIfSwitch_0 (EthIfSwitch): EthIfSwitchIdx=0, EthIfSwitchRef=EthSwtConfig_0
      EthIfTransceiver_0 (EthIfTransceiver): EthIfTransceiverIdx=0, EthIfEthTrcvRef=EthTrcvConfig_0
      EthIfTrcvLinkStateChgConfig_0 (EthIfTrcvLinkStateChgConfig): EthIfTrcvLinkStateChgFunction=Cdd_EthIfLinkStateChange
      EthIfTxConfirmationConfig_0 (EthIfTxConfirmationConfig): EthIfTxConfirmationFunction=Cdd_EthIfTxConfirmation
    EthIfGeneral_0 (EthIfGeneral):
      EthIfDevErrorDetect = false
      EthIfEnableRxInterrupt = false
      EthIfEnableSecurityEventReporting = true
      EthIfEnableSignalQualityApi = false
      EthIfEnableTxInterrupt = false
      EthIfGetAndResetMeasurementDataApi = true
      EthIfGetBaudRate = true
      EthIfGetCounterState = true
      EthIfGetCtrlIdxList = true
      EthIfGetVlanIdSupport = true
      EthIfGlobalTimeSupport = true
      EthIfMainFunctionPeriod = 0.005
      EthIfMaxTrcvsTotal = 1
      EthIfPublicCddHeaderFile = Cdd
      EthIfRxIndicationIterations = 5
      EthIfSetForwardingModeApi = false
      EthIfStartAutoNegotiation = true
      EthIfSwitchManagementSupport = false
      EthIfTrcvLinkStateChgMainReload = 2
      EthIfVerifyConfigApi = false
      EthIfVersionInfoApi = true
      EthIfVersionInfoApiMacro = false
      EthIfWakeUpSupport = false
      EthIfFwSupport = NO_FIREWALL
      EthIfPhcSupport = false
      EthIfSecurityEventRefs_0 (EthIfSecurityEventRefs):
        SEV_ETH_DROP_INV_VLAN = IdsMEvent_15
        SEV_ETH_DROP_MAC_COLLISION = IdsMEvent_16
        SEV_ETH_DROP_UNKNOWN_ETHERTYPE = IdsMEvent_17
        SEV_ETH_DROP_VLAN_DOUBLE_TAG = IdsMEvent_18
  module config EthSwt_0: definition=EthSwt
    EthSwtConfig_0 (EthSwtConfig): EthSwtIdx=0
      EthSwtPort_0 (EthSwtPort): EthSwtPortEnableLinkDownCallback=, EthSwtPortIdx=, EthSwtPortPhysicalLayerType=
        EthSwtPortEgress_0 (EthSwtPortEgress): EthSwtPortEgressLastSchedulerRef=(unset)
          EthSwtPortFifo_0 (EthSwtPortFifo)
          EthSwtPortScheduler_0 (EthSwtPortScheduler): EthSwtPortSchedulerAlgorithm=
            EthSwtPortSchedulerPredecessor_0 (EthSwtPortSchedulerPredecessor): EthSwtPortSchedulerPredecessorOrder=, EthSwtPortEgressPredecessorRef=(unset)
        EthSwtPortIngress_0 (EthSwtPortIngress)
    EthSwtGeneral_0 (EthSwtGeneral):
      EthSwtGetBufferLevelApi = 
      EthSwtGetDropCountApi = 
      EthSwtGetEtherStatsApi = 
      EthSwtDevErrorDetect = 
      EthSwtEnableVlanApi = 
      EthSwtGetArlTableApi = 
      EthSwtGetMacLearningModeApi = 
      EthSwtGetPortMacAddrApi = 
      EthSwtGetSwitchRegApi = 
      EthSwtIndex = 
      EthSwtPersistentConfigurationResult = 
      EthSwtReadTrcvRegisterApi = 
      EthSwtResetConfigurationApi = 
      EthSwtSetMacLearningModeApi = 
      EthSwtSetSwitchRegApi = 
      EthSwtStoreConfigurationApi = 
      EthSwtVersionInfoApi = 
      EthSwtWriteTrcvRegisterApi = 
  module config EthTrcv_0: definition=EthTrcv, ecuc-def-edition=4.2.2, implementation-config-variant=VARIANT-PRE-COMPILE, module-description=EthTrcv_Impl
    EthTrcvConfigSet_0 (EthTrcvConfigSet)
      EthTrcvConfig_0 (EthTrcvConfig): EthTrcvAutoNegotiationEnabled=(unset), EthTrcvCtrlIdx=0, EthTrcvMiiIdx=(unset), EthTrcvConnNeg=, EthTrcvDuplexMode=, EthTrcvIdx=0, EthTrcvSpeed=
    EthTrcvGeneral_0 (EthTrcvGeneral):
      EthTrcvGetTransceiverModeApi = (unset)
      EthTrcvSetTransceiverModeApi = (unset)
      EthTrcvDevErrorDetect = (unset)
      EthTrcvGetBaudRateApi = (unset)
      EthTrcvGetDuplexModeApi = (unset)
      EthTrcvGetLinkStateApi = (unset)
      EthTrcvIndex = (unset)
      EthTrcvMaxTrcvsSupported = 1
      EthTrcvStartAutoNegotiationApi = (unset)
      EthTrcvVersionInfoApi = (unset)
      EthTrcvVersionInfoApiMacro = (unset)
      EthTrcvWakeUpSupport = ETHTRCV_WAKEUP_BY_POLLING
  module config Eth_0: definition=Eth
    EthConfigSet_0 (EthConfigSet)
      EthCtrlConfig_0 (EthCtrlConfig):
        EthCtrlRxBufLenByte = 
        EthCtrlTxBufLenByte = 
        EthRxBufTotal = 
        EthTxBufTotal = 
        EthCtrlEnableMii = 
        EthCtrlEnableRxInterrupt = 
        EthCtrlEnableTxInterrupt = 
        EthCtrlIdx = 0
        EthCtrlEnableEgressHardwareSupportedDataTransfer = true
        EthClkUnit_0 (EthClkUnit): EthClkUnitCrossTimestampingSupport=NO_XTIMESTAMPING, EthClkUnitIdx=0, EthClkUnitTimeStampingRef=(unset)
        EthCtrlConfigEgress_0 (EthCtrlConfigEgress): EthCtrlConfigEgressLastSchedulerRef=(unset)
          EthCtrlConfigEgressQueue_0 (EthCtrlConfigEgressQueue): index=0, EthCtrlConfigEgressQueueBufLenByte=(unset), EthCtrlConfigEgressQueueBufTotal=(unset), EthCtrlConfigEgressQueueIdx=0
            EthCtrlConfigEgressQueueTransmissionSelection_0 (EthCtrlConfigEgressQueueTransmissionSelection): EthCtrlConfigEgressQueueTransmissionSelectionAlgorithm=ETH_TRANSMISSION_SELECTION_UNSHAPED
          EthCtrlConfigScheduler_0 (EthCtrlConfigScheduler): EthCtrlConfigSchedulerAlgorithm=
            EthCtrlConfigSchedulerPredecessor_0 (EthCtrlConfigSchedulerPredecessor): EthCtrlConfigSchedulerPredecessorOrder=(unset), EthCtrlConfigSchedulerPredecessorRef=(unset)
      EthCtrlConfig_1 (EthCtrlConfig):
        EthCtrlRxBufLenByte = 
        EthCtrlTxBufLenByte = 
        EthRxBufTotal = 
        EthTxBufTotal = 
        EthCtrlEnableMii = 
        EthCtrlEnableRxInterrupt = 
        EthCtrlEnableTxInterrupt = 
        EthCtrlIdx = 1
        EthCtrlEnableEgressHardwareSupportedDataTransfer = false
        EthClkUnit_0 (EthClkUnit): EthClkUnitCrossTimestampingSupport=NO_XTIMESTAMPING, EthClkUnitIdx=1, EthClkUnitTimeStampingRef=(unset)
    EthGeneral_0 (EthGeneral):
      EthGetDropCountApi = 
      EthGetEtherStatsApi = 
      EthUpdatePhysAddrFilter = false
      EthDevErrorDetect = 
      EthGlobalTimeSupport = 
      EthIndex = 
      EthMainFunctionPeriod = 
      EthMaxCtrlsSupported = 
      EthVersionInfoApi = 
      EthCtrlOffloading_0 (EthCtrlOffloading): EthCtrlEnableOffloadChecksumICMP=, EthCtrlEnableOffloadChecksumIPv4=, EthCtrlEnableOffloadChecksumTCP=, EthCtrlEnableOffloadChecksumUDP=
  module config IdsM_0: definition=IdsM, ecuc-def-edition=4.10.0, implementation-config-variant=VARIANT-PRE-COMPILE
    IdsMConfiguration_0 (IdsMConfiguration)
      IdsMBufferConfiguration_0 (IdsMBufferConfiguration): IdsMEventDisplacementStrategy=
        IdsMEventBuffers_0 (IdsMEventBuffers): IdsMNumberOfEventBuffers=(unset)
        IdsMQualifiedEventBuffers_0 (IdsMQualifiedEventBuffers): IdsMNumberOfQualifiedEventBuffers=(unset)
      4 x IdsMEvent, all with IdsMExternalEventId=(unset), IdsMInternalEventId=65535, IdsMReportingModeFilter=, IdsMSensorInstanceId=0, IdsMSinkDem=false, IdsMSinkIdsR=false:
        IdsMEvent_{15..18}
    IdsMGeneral_0 (IdsMGeneral):
      IdsMDevErrorDetect = (unset)
      IdsMDiagnosticSupport = false
      IdsMEnableSecurityEventReporting = false
      IdsMInstanceId = (unset)
      IdsMMainFunctionPeriod = 0.01
      IdsMSignatureSupport = false
      IdsMTimestampSupport = false
      IdsMVersionInfoApi = (unset)
  module config EcuC_0: definition=EcuC, ecuc-def-edition=4.10.0, implementation-config-variant=VARIANT-PRE-COMPILE
    EcucHardware_0 (EcucHardware)
      EcucCoreDefinition_0 (EcucCoreDefinition): EcucCoreId=(unset)
    EcucConfigSet_0 (EcucConfigSet)
      EcucPduCollection_0 (EcucPduCollection): PduIdTypeEnum=, PduLengthTypeEnum=
        Pdu_0 (Pdu): PduLength=12, KeepLocalPduBuffer=false, MetaDataTypeRef=MetaDataType_0
        MetaDataType_0 (MetaDataType)
          MetaDataItem_0 (MetaDataItem): index=0, MetaDataItemLength=6, MetaDataItemType=ETHERNET_MAC_64
        Pdu_1 (Pdu): PduLength=12, KeepLocalPduBuffer=true, MetaDataTypeRef=MetaDataType_0
        Pdu_2 (Pdu): PduLength=12, KeepLocalPduBuffer=true, MetaDataTypeRef=MetaDataType_0
  module config LSduR_0: definition=LSduR, ecuc-def-edition=4.10.0, implementation-config-variant=VARIANT-PRE-COMPILE, module-description=LSDUR_Impl
    LSduRConfig_0 (LSduRConfig): LSduRConfigurationId=(unset)
      3 x LSduRPath:
        LSduRPath_0
          LSduRPathDestinationPdu_0 (LSduRPathDestinationPdu): LSduRPathDestinationPduId=0, LSduRPathDestinationPduRef=Pdu_0
          LSduRPathSourcePdu_0 (LSduRPathSourcePdu)
        LSduRPath_1
          LSduRPathDestinationPdu_0 (LSduRPathDestinationPdu): LSduRPathDestinationPduId=1, LSduRPathDestinationPduRef=Pdu_1
          LSduRPathSourcePdu_0 (LSduRPathSourcePdu): LSduRPathSourcePduRef=(unset)
        LSduRPath_2
          LSduRPathDestinationPdu_0 (LSduRPathDestinationPdu): LSduRPathDestinationPduId=2, LSduRPathDestinationPduRef=Pdu_2
          LSduRPathSourcePdu_0 (LSduRPathSourcePdu): LSduRPathSourcePduRef=(unset)
    LSduRGeneral_0 (LSduRGeneral): LSduRDevErrorDetect=false, LSduRMetaDataSupport=(unset), LSduRVersionInfoApi=false, LSduRZeroCostOperation=(unset)
