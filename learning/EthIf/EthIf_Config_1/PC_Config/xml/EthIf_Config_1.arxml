AUTOSAR XML (schema 00053)
package /ARRoot
  module config EthIf_0: definition=EthIf, implementation-config-variant=VARIANT-PRE-COMPILE, module-description=EthIf_Impl
    EthIfConfigSet_0 (EthIfConfigSet)
      8 x EthIfController, all with EthIfCtrlMtu=1500, EthIfMaxTxBufsTotal=10:
        EthIfController_0: EthIfCtrlIdx=0, EthIfVlanId=2, EthIfEthTrcvRef=EthIfTransceiver_0, EthIfPhysControllerRef=EthIfPhysController_0
        EthIfController_1: EthIfCtrlIdx=1, EthIfPhysControllerRef=EthIfPhysController_1
        EthIfController_2: EthIfCtrlIdx=2, EthIfVlanId=2, EthIfPhysControllerRef=EthIfPhysController_0
        EthIfController_3: EthIfCtrlIdx=3, EthIfVlanId=7, EthIfPhysControllerRef=EthIfPhysController_0
        EthIfController_4: EthIfCtrlIdx=4, EthIfVlanId=8, EthIfPhysControllerRef=EthIfPhysController_1
        EthIfController_5: EthIfCtrlIdx=5, EthIfVlanId=9, EthIfPhysControllerRef=EthIfPhysController_1
        EthIfController_6: EthIfCtrlIdx=6, EthIfVlanId=500, EthIfPhysControllerRef=EthIfPhysController_1
        EthIfController_7: EthIfCtrlIdx=7, EthIfPhysControllerRef=EthIfPhysController_1
      EthIfPhysController_0 (EthIfPhysController): EthIfPhysControllerIdx=0, EthIfEthCtrlRef=EthCtrlConfig_0
        EthIfClkUnit_0 (EthIfClkUnit): EthIfClkUnitIdx=0, EthIfClkUnitRef=EthCtrlConfig_0/EthClkUnit_0
      EthIfPhysController_1 (EthIfPhysController): EthIfPhysControllerIdx=1, EthIfEthCtrlRef=EthCtrlConfig_1, EthIfCanXLCtrlRef=(unset)
        EthIfClkUnit_0 (EthIfClkUnit): EthIfClkUnitIdx=0, EthIfClkUnitRef=EthCtrlConfig_1/EthClkUnit_0
      EthIfRxIndicationConfig_0 (EthIfRxIndicationConfig): EthIfRxIndicationFunction=TcpIp_RxIndication
      EthIfRxIndicationConfig_1 (EthIfRxIndicationConfig): EthIfRxIndicationFunction=TcpIp_RxIndication
      EthIfSwitch_0 (EthIfSwitch): EthIfSwitchIdx=0, EthIfSwitchRef=EthSwtConfig_0
      EthIfTransceiver_0 (EthIfTransceiver): EthIfTransceiverIdx=0, EthIfEthTrcvRef=EthTrcvConfig_0
      EthIfTrcvLinkStateChgConfig_0 (EthIfTrcvLinkStateChgConfig): EthIfTrcvLinkStateChgFunction=Cdd_EthIfLinkStateChange
      EthIfTxConfirmationConfig_0 (EthIfTxConfirmationConfig): EthIfTxConfirmationFunction=Cdd_EthIfTxConfirmation
      EthIfFrameConfig_0 (EthIfFrameConfig): EthIfFrameType=2048, EthIfOwner=0
        EthIfFrameTxPool_0 (EthIfFrameTxPool): EthIfFrameTxPriority=1, EthIfFrameTxControllerRef=EthIfController_2
          EthIf_TxMsg_0 (EthIfFrameTxPdu): EthIfFrameTxPduId=0, EthIfFrameTxPduRef=Pdu_AVTP
        EthIfFrameRxPool_0 (EthIfFrameRxPool): EthIfFrameRxControllerRef=EthIfController_0
          EthIf_RxMsg_0 (EthIfFrameRxPdu): EthIfFrameRxPduId=0, EthIfFrameRxPduRef=Pdu_AuthenticData_Rx
      EthIfFrameConfig_1 (EthIfFrameConfig): EthIfFrameType=35063, EthIfOwner=1
        EthIfFrameTxPool_0 (EthIfFrameTxPool): EthIfFrameTxPriority=(unset), EthIfFrameTxControllerRef=EthIfController_1
          EthIf_TxMsg_1 (EthIfFrameTxPdu): EthIfFrameTxPduId=1, EthIfFrameTxPduRef=Pdu_AuthenticData_Rx_SecOC_P3
        EthIfFrameRxPool_0 (EthIfFrameRxPool)
          EthIf_RxMsg_2 (EthIfFrameRxPdu): EthIfFrameRxPduId=2, EthIfFrameRxPduRef=Pdu_AuthenticData_Rx_Crypt
    EthIfGeneral_0 (EthIfGeneral):
      EthIfDevErrorDetect = true
      EthIfEnableRxInterrupt = false
      EthIfEnableSecurityEventReporting = false
      EthIfEnableSignalQualityApi = false
      EthIfEnableTxInterrupt = false
      EthIfGetAndResetMeasurementDataApi = false
      EthIfGetBaudRate = true
      EthIfGetCounterState = true
      EthIfGetCtrlIdxList = true
      EthIfGetVlanIdSupport = true
      EthIfGlobalTimeSupport = true
      EthIfMainFunctionPeriod = 0.005
      EthIfMaxTrcvsTotal = 1
      EthIfPublicCddHeaderFile = Cdd
      EthIfRxIndicationIterations = 5
      EthIfSetForwardingModeApi = false
      EthIfStartAutoNegotiation = true
      EthIfSwitchManagementSupport = false
      EthIfTrcvLinkStateChgMainReload = 2
      EthIfVerifyConfigApi = false
      EthIfVersionInfoApi = true
      EthIfVersionInfoApiMacro = false
      EthIfWakeUpSupport = false
      EthIfFwSupport = NO_FIREWALL
      EthIfPhcSupport = true
  module config EthSwt_0: definition=EthSwt
    EthSwtConfig_0 (EthSwtConfig): EthSwtIdx=0
      EthSwtPort_0 (EthSwtPort): EthSwtPortEnableLinkDownCallback=, EthSwtPortIdx=, EthSwtPortPhysicalLayerType=
        EthSwtPortEgress_0 (EthSwtPortEgress): EthSwtPortEgressLastSchedulerRef=(unset)
          EthSwtPortFifo_0 (EthSwtPortFifo)
          EthSwtPortScheduler_0 (EthSwtPortScheduler): EthSwtPortSchedulerAlgorithm=
            EthSwtPortSchedulerPredecessor_0 (EthSwtPortSchedulerPredecessor): EthSwtPortSchedulerPredecessorOrder=, EthSwtPortEgressPredecessorRef=(unset)
        EthSwtPortIngress_0 (EthSwtPortIngress)
    EthSwtGeneral_0 (EthSwtGeneral):
      EthSwtDevErrorDetect = 
      EthSwtEnableVlanApi = 
      EthSwtGetArlTableApi = 
      EthSwtGetBufferLevelApi = 
      EthSwtGetDropCountApi = 
      EthSwtGetEtherStatsApi = 
      EthSwtGetMacLearningModeApi = 
      EthSwtGetPortMacAddrApi = 
      EthSwtGetSwitchRegApi = 
      EthSwtIndex = 
      EthSwtPersistentConfigurationResult = 
      EthSwtReadTrcvRegisterApi = 
      EthSwtResetConfigurationApi = 
      EthSwtSetMacLearningModeApi = 
      EthSwtSetSwitchRegApi = 
      EthSwtStoreConfigurationApi = 
      EthSwtVersionInfoApi = 
      EthSwtWriteTrcvRegisterApi = 
  module config EthTrcv_0: definition=EthTrcv, ecuc-def-edition=4.2.2, implementation-config-variant=VARIANT-PRE-COMPILE, module-description=EthTrcv_Impl
    EthTrcvConfigSet_0 (EthTrcvConfigSet)
      EthTrcvConfig_0 (EthTrcvConfig): EthTrcvAutoNegotiationEnabled=(unset), EthTrcvCtrlIdx=0, EthTrcvMiiIdx=(unset), EthTrcvConnNeg=, EthTrcvDuplexMode=, EthTrcvIdx=0, EthTrcvSpeed=
    EthTrcvGeneral_0 (EthTrcvGeneral):
      EthTrcvGetTransceiverModeApi = (unset)
      EthTrcvSetTransceiverModeApi = (unset)
      EthTrcvDevErrorDetect = (unset)
      EthTrcvGetBaudRateApi = (unset)
      EthTrcvGetDuplexModeApi = (unset)
      EthTrcvGetLinkStateApi = (unset)
      EthTrcvIndex = (unset)
      EthTrcvMaxTrcvsSupported = 1
      EthTrcvStartAutoNegotiationApi = (unset)
      EthTrcvVersionInfoApi = (unset)
      EthTrcvVersionInfoApiMacro = (unset)
      EthTrcvWakeUpSupport = ETHTRCV_WAKEUP_BY_POLLING
  module config Eth_0: definition=Eth
    EthConfigSet_0 (EthConfigSet)
      EthCtrlConfig_0 (EthCtrlConfig):
        EthCtrlRxBufLenByte = 
        EthCtrlTxBufLenByte = 
        EthRxBufTotal = 
        EthTxBufTotal = 
        EthCtrlEnableMii = 
        EthCtrlEnableRxInterrupt = 
        EthCtrlEnableTxInterrupt = 
        EthCtrlIdx = 0
        EthCtrlPhyAddress = (unset)
        EthCtrlEnableEgressHardwareSupportedDataTransfer = false
        EthClkUnit_0 (EthClkUnit): EthClkUnitCrossTimestampingSupport=NO_XTIMESTAMPING, EthClkUnitIdx=0, EthClkUnitTimeStampingRef=(unset)
      EthCtrlConfig_1 (EthCtrlConfig):
        EthCtrlRxBufLenByte = 
        EthCtrlTxBufLenByte = 
        EthRxBufTotal = 
        EthTxBufTotal = 
        EthCtrlEnableMii = 
        EthCtrlEnableRxInterrupt = 
        EthCtrlEnableTxInterrupt = 
        EthCtrlIdx = 1
        EthCtrlEnableEgressHardwareSupportedDataTransfer = false
        EthClkUnit_0 (EthClkUnit): EthClkUnitCrossTimestampingSupport=NO_XTIMESTAMPING, EthClkUnitIdx=0, EthClkUnitTimeStampingRef=(unset)
    EthGeneral_0 (EthGeneral):
      EthGetDropCountApi = 
      EthGetEtherStatsApi = 
      EthUpdatePhysAddrFilter = false
      EthDevErrorDetect = 
      EthGlobalTimeSupport = 
      EthIndex = 
      EthMainFunctionPeriod = 
      EthMaxCtrlsSupported = 
      EthVersionInfoApi = 
      EthCtrlOffloading_0 (EthCtrlOffloading): EthCtrlEnableOffloadChecksumICMP=, EthCtrlEnableOffloadChecksumIPv4=, EthCtrlEnableOffloadChecksumTCP=, EthCtrlEnableOffloadChecksumUDP=
  module config EcuC_0: definition=EcuC, ecuc-def-edition=4.10.0, implementation-config-variant=VARIANT-PRE-COMPILE
    EcucConfigSet_0 (EcucConfigSet): EcucSafeKSAR=true
      EcucPduCollection_0 (EcucPduCollection): PduIdTypeEnum=UINT8, PduLengthTypeEnum=UINT8
        90 x Pdu:
          Pdu_AppSd: PduLength=8, PduBufferAlignment=, KeepLocalPduBuffer=false, EcucPduDefaultPartitionRef=EcucPartition_Trusted_Master, MetaDataTypeRef=MetaDataType_0
          Pdu_AuthenticData_Rx: PduLength=10, EcucPduDefaultPartitionRef=EcucPartition_Trusted_Master, MetaDataTypeRef=MetaDataType_2
          Pdu_AuthenticData_Rx_AEADD: PduLength=10, EcucPduDefaultPartitionRef=EcucPartition_Trusted_Master, MetaDataTypeRef=MetaDataType_2
          Pdu_AuthenticData_Rx_Crypt: PduLength=10, EcucPduDefaultPartitionRef=EcucPartition_Trusted_Master, MetaDataTypeRef=MetaDataType_3
          Pdu_AuthenticData_Rx_Dyn: DynamicLength=true, PduLength=10, EcucPduDefaultPartitionRef=EcucPartition_Trusted_Master, MetaDataTypeRef=MetaDataType_3
          Pdu_AuthenticData_Rx_P1: PduLength=10, EcucPduDefaultPartitionRef=EcucPartition_Trusted_Master
          Pdu_AuthenticData_Rx_SecOC_P2: PduLength=10, EcucPduDefaultPartitionRef=EcucPartition_Trusted_Master, MetaDataTypeRef=MetaDataType_1
          Pdu_AuthenticData_Rx_SecOC_P3: PduLength=10, KeepLocalPduBuffer=false, EcucPduDefaultPartitionRef=EcucPartition_Trusted_Master, MetaDataTypeRef=MetaDataType_1
          Pdu_AuthenticData_Rx_SecureCounter: PduLength=10, EcucPduDefaultPartitionRef=EcucPartition_Trusted_Master
          Pdu_AuthenticData_Rx_Signature: PduLength=10, EcucPduDefaultPartitionRef=EcucPartition_Trusted_Master
          Pdu_AuthenticData_Rx_Tp: PduLength=10, EcucPduDefaultPartitionRef=EcucPartition_Trusted_Master
          Pdu_AuthenticData_Tx: PduLength=10, EcucPduDefaultPartitionRef=EcucPartition_Trusted_Master
          Pdu_AuthenticData_Tx_AEADD: PduLength=10, EcucPduDefaultPartitionRef=EcucPartition_Trusted_Master, MetaDataTypeRef=MetaDataType_1
          Pdu_AuthenticData_Tx_Crypt: PduLength=10, EcucPduDefaultPartitionRef=EcucPartition_Trusted_Master
          Pdu_AuthenticData_Tx_Dyn: DynamicLength=true, PduLength=10, EcucPduDefaultPartitionRef=EcucPartition_Trusted_Master
          Pdu_AuthenticData_Tx_P1: PduLength=10, EcucPduDefaultPartitionRef=EcucPartition_Trusted_Master
          Pdu_AuthenticData_Tx_SecOC_P2: PduLength=10, EcucPduDefaultPartitionRef=EcucPartition_Trusted_Master
          Pdu_AuthenticData_Tx_SecOC_P3: PduLength=10, KeepLocalPduBuffer=true, EcucPduDefaultPartitionRef=EcucPartition_Trusted_Master
          Pdu_AuthenticData_Tx_SecureCounter: PduLength=10, EcucPduDefaultPartitionRef=EcucPartition_Trusted_Master
          Pdu_AuthenticData_Tx_Signature: PduLength=10, EcucPduDefaultPartitionRef=EcucPartition_Trusted_Master
          Pdu_AuthenticData_Tx_Tp: PduLength=10, EcucPduDefaultPartitionRef=EcucPartition_Trusted_Master
          Pdu_Dcm_DoIP_Func_Rx: PduLength=8, EcucPduDefaultPartitionRef=EcucPartition_Trusted_Master
          Pdu_Dcm_DoIP_Func_Tx: PduLength=8, EcucPduDefaultPartitionRef=EcucPartition_Trusted_Master
          Pdu_Dcm_DoIP_Phys_Rx: PduLength=8, EcucPduDefaultPartitionRef=EcucPartition_Trusted_Master
          Pdu_Dcm_DoIP_Phys_Tx: PduLength=8, EcucPduDefaultPartitionRef=EcucPartition_Trusted_Master
          Pdu_DoIP_SoAd_Tcp_Dummy_Rx: PduLength=8, EcucPduDefaultPartitionRef=EcucPartition_Trusted_Master
          Pdu_DoIP_SoAd_Tcp_Dummy_Tx: PduLength=8, EcucPduDefaultPartitionRef=EcucPartition_Trusted_Master
          Pdu_DoIP_SoAd_Tcp_Tester_Rx: PduLength=256, EcucPduDefaultPartitionRef=EcucPartition_Trusted_Master
          Pdu_DoIP_SoAd_Tcp_Tester_Tx: PduLength=256, EcucPduDefaultPartitionRef=EcucPartition_Trusted_Master
          Pdu_DoIP_SoAd_Udp_Rx: PduLength=32, EcucPduDefaultPartitionRef=EcucPartition_Trusted_Master
          Pdu_DoIP_SoAd_Udp_RxBcast: PduLength=32, EcucPduDefaultPartitionRef=EcucPartition_Trusted_Master
          Pdu_DoIP_SoAd_Udp_Tx: PduLength=64, EcucPduDefaultPartitionRef=EcucPartition_Trusted_Master
          Pdu_DoIP_SoAd_Udp_TxBcast: PduLength=64, EcucPduDefaultPartitionRef=EcucPartition_Trusted_Master
          Pdu_Eth0_NMS_Tx: PduLength=6, EcucPduDefaultPartitionRef=EcucPartition_Trusted_Master
          Pdu_EtmApp_Rx: PduLength=50, EcucPduDefaultPartitionRef=EcucPartition_Trusted_Master
          Pdu_EtmApp_Tx: PduLength=64, EcucPduDefaultPartitionRef=EcucPartition_Trusted_Master
          Pdu_Etm_Rx: PduLength=16, EcucPduDefaultPartitionRef=EcucPartition_Trusted_Master
          Pdu_Etm_Tx: PduLength=64, EcucPduDefaultPartitionRef=EcucPartition_Trusted_Master
          Pdu_IdsM_Tx: PduLength=8, EcucPduDefaultPartitionRef=EcucPartition_Trusted_Master
          Pdu_P4_In: PduLength=60, EcucPduDefaultPartitionRef=EcucPartition_Trusted_Master
          Pdu_P4_Out: PduLength=60, EcucPduDefaultPartitionRef=EcucPartition_Trusted_Master
          Pdu_P4m_ReqData: PduLength=500, EcucPduDefaultPartitionRef=EcucPartition_Trusted_Master, EcucPduDefaultPartitionRef=EcucPartition_Trusted_Master
          Pdu_P4m_Resdata: PduLength=500, EcucPduDefaultPartitionRef=EcucPartition_Trusted_Master, EcucPduDefaultPartitionRef=EcucPartition_Trusted_Master
          Pdu_P6_In: PduLength=60, EcucPduDefaultPartitionRef=EcucPartition_Trusted_Master
          Pdu_P6_Out: PduLength=60, EcucPduDefaultPartitionRef=EcucPartition_Trusted_Master
          Pdu_P7_In: PduLength=60, EcucPduDefaultPartitionRef=EcucPartition_Trusted_Master
          Pdu_P7_Out: PduLength=60, EcucPduDefaultPartitionRef=EcucPartition_Trusted_Master
          Pdu_Rx_SDMulticast: PduLength=80, EcucPduDefaultPartitionRef=EcucPartition_Trusted_Master
          Pdu_Rx_SDUnicast: PduLength=80, EcucPduDefaultPartitionRef=EcucPartition_Trusted_Master
          Pdu_Rx_UdpNm: PduLength=8, EcucPduDefaultPartitionRef=EcucPartition_Trusted_Master
          Pdu_SD_EMS_EngineModel_InitialEvent: PduLength=3, EcucPduDefaultPartitionRef=EcucPartition_Trusted_Master
          Pdu_SD_SoAd_Tcp_Dummy_Rx: PduLength=8, EcucPduDefaultPartitionRef=EcucPartition_Trusted_Master
          Pdu_SD_SoAd_Tcp_Dummy_Tx: PduLength=8, EcucPduDefaultPartitionRef=EcucPartition_Trusted_Master
          Pdu_SOMEIP_VEHICLE_ENGINE_COOLANT_TEMP_FF_IN: PduLength=11, EcucPduDefaultPartitionRef=EcucPartition_Trusted_Master
          Pdu_SecuredData_Rx: PduLength=64, EcucPduDefaultPartitionRef=EcucPartition_Trusted_Master
          Pdu_SecuredData_Rx_AEADD: PduLength=64, EcucPduDefaultPartitionRef=EcucPartition_Trusted_Master
          Pdu_SecuredData_Rx_Crypt: PduLength=64, EcucPduDefaultPartitionRef=EcucPartition_Trusted_Master
          Pdu_SecuredData_Rx_Dyn: DynamicLength=true, PduLength=64, EcucPduDefaultPartitionRef=EcucPartition_Trusted_Master
          Pdu_SecuredData_Rx_P1: PduLength=64, EcucPduDefaultPartitionRef=EcucPartition_Trusted_Master
          Pdu_SecuredData_Rx_SecOC_P2: PduLength=64, EcucPduDefaultPartitionRef=EcucPartition_Trusted_Master
          Pdu_SecuredData_Rx_SecOC_P3: PduLength=64, EcucPduDefaultPartitionRef=EcucPartition_Trusted_Master
          Pdu_SecuredData_Rx_SecureCounter: PduLength=64, EcucPduDefaultPartitionRef=EcucPartition_Trusted_Master
          Pdu_SecuredData_Rx_Signature: PduLength=64, EcucPduDefaultPartitionRef=EcucPartition_Trusted_Master
          Pdu_SecuredData_Rx_Tp: PduLength=64, EcucPduDefaultPartitionRef=EcucPartition_Trusted_Master
          Pdu_SecuredData_Tx: PduLength=64, EcucPduDefaultPartitionRef=EcucPartition_Trusted_Master
          Pdu_SecuredData_Tx_AEADD: PduLength=64, EcucPduDefaultPartitionRef=EcucPartition_Trusted_Master
          Pdu_SecuredData_Tx_Crypt: PduLength=64, EcucPduDefaultPartitionRef=EcucPartition_Trusted_Master
          Pdu_SecuredData_Tx_Dyn: DynamicLength=true, PduLength=64, EcucPduDefaultPartitionRef=EcucPartition_Trusted_Master
          Pdu_SecuredData_Tx_P1: PduLength=64, EcucPduDefaultPartitionRef=EcucPartition_Trusted_Master
          Pdu_SecuredData_Tx_SecOC_P2: PduLength=64, EcucPduDefaultPartitionRef=EcucPartition_Trusted_Master
          Pdu_SecuredData_Tx_SecOC_P3: PduLength=64, EcucPduDefaultPartitionRef=EcucPartition_Trusted_Master
          Pdu_SecuredData_Tx_SecureCounter: PduLength=64, EcucPduDefaultPartitionRef=EcucPartition_Trusted_Master
          Pdu_SecuredData_Tx_Signature: PduLength=64, EcucPduDefaultPartitionRef=EcucPartition_Trusted_Master
          Pdu_SecuredData_Tx_Tp: PduLength=64, EcucPduDefaultPartitionRef=EcucPartition_Trusted_Master
          Pdu_SomeIpTp_Rx: PduLength=1200, EcucPduDefaultPartitionRef=EcucPartition_Trusted_Master
          Pdu_SomeIpTp_Rx1: PduLength=1108, EcucPduDefaultPartitionRef=EcucPartition_Trusted_Master
          Pdu_SomeIpTp_Tx: PduLength=1200, EcucPduDefaultPartitionRef=EcucPartition_Trusted_Master
          Pdu_SomeIpTp_Tx1: PduLength=1128, EcucPduDefaultPartitionRef=EcucPartition_Trusted_Master
          Pdu_TCF: PduLength=8, EcucPduDefaultPartitionRef=EcucPartition_Trusted_Master
          Pdu_TSF: PduLength=8, EcucPduDefaultPartitionRef=EcucPartition_Trusted_Master
          Pdu_Tx_SD: PduLength=80, EcucPduDefaultPartitionRef=EcucPartition_Trusted_Master
          Pdu_Tx_UdpNm: PduLength=8, EcucPduDefaultPartitionRef=EcucPartition_Trusted_Master
          Sdu_SomeIpTp_Rx: PduLength=5579, EcucPduDefaultPartitionRef=EcucPartition_Trusted_Master
          Sdu_SomeIpTp_Rx1: PduLength=1108, EcucPduDefaultPartitionRef=EcucPartition_Trusted_Master
          Sdu_SomeIpTp_Tx: PduLength=5579, EcucPduDefaultPartitionRef=EcucPartition_Trusted_Master
          Sdu_SomeIpTp_Tx1: PduLength=1108, EcucPduDefaultPartitionRef=EcucPartition_Trusted_Master
          pdu_SOMEIP_Throttle_Position_GETTER_CALL_IN: J1939Requestable=false, PduLength=8, EcucPduDefaultPartitionRef=EcucPartition_Trusted_Master, EcucPduDefaultPartitionRef=EcucPartition_Trusted_Master
          pdu_SOMEIP_Throttle_Position_GETTER_RETURN_OUT: J1939Requestable=false, PduLength=9, EcucPduDefaultPartitionRef=EcucPartition_Trusted_Master, EcucPduDefaultPartitionRef=EcucPartition_Trusted_Master
          pdu_SOMEIP_Vehicle_Speed_SETTER_CALL_IN: PduLength=9, EcucPduDefaultPartitionRef=EcucPartition_Trusted_Master, EcucPduDefaultPartitionRef=EcucPartition_Trusted_Master
          pdu_SOMEIP_Vehicle_Speed_SETTER_RETURN_OUT: PduLength=9, EcucPduDefaultPartitionRef=EcucPartition_Trusted_Master, EcucPduDefaultPartitionRef=EcucPartition_Trusted_Master
        MetaDataType_0 (MetaDataType)
          MetaDataItem_0 (MetaDataItem): index=0, MetaDataItemLength=8, MetaDataItemType=ETHERNET_MAC_64
          MetaDataItem_1 (MetaDataItem): index=1, MetaDataItemLength=4, MetaDataItemType=LISTELEM_PTR
        MetaDataType_1 (MetaDataType)
          3 x MetaDataItem:
            MetaDataItem_0: index=0, MetaDataItemLength=8, MetaDataItemType=ETHERNET_MAC_64
            MetaDataItem_1: index=1, MetaDataItemLength=4, MetaDataItemType=LISTELEM_PTR
            MetaDataItem_2: index=2, MetaDataItemLength=1, MetaDataItemType=PRIORITY_8
        Pdu_AVTP (Pdu): PduLength=8, PduBufferAlignment=, KeepLocalPduBuffer=false, EcucPduDefaultPartitionRef=EcucPartition_Trusted_Master, MetaDataTypeRef=MetaDataType_0
        MetaDataType_2 (MetaDataType)
          MetaDataItem_0 (MetaDataItem): index=0, MetaDataItemLength=8, MetaDataItemType=ETHERNET_MAC_64
          MetaDataItem_1 (MetaDataItem): index=1, MetaDataItemLength=1, MetaDataItemType=BROADCAST_8
        MetaDataType_3 (MetaDataType)
          MetaDataItem_0 (MetaDataItem): index=0, MetaDataItemLength=8, MetaDataItemType=ETHERNET_MAC_64
    EcucHardware_0 (EcucHardware)
      EcucCoreDefinition_0 (EcucCoreDefinition): EcucCoreId=0
    EcucPartitionCollection_0 (EcucPartitionCollection)
      5 x EcucPartition, all with EcucPartitionCoreRef=EcucCoreDefinition_0:
        EcucPartition_NonTrusted_01: PartitionCanBeRestarted=true, EcucPartitionId=2, EcucPartitionSoftwareComponentInstanceRef=ASWC_NonTrustedApp01
        EcucPartition_NonTrusted_02: PartitionCanBeRestarted=true, EcucPartitionId=4, EcucPartitionSoftwareComponentInstanceRef=ASWC_NonTrustedApp02
        EcucPartition_Trusted_01: PartitionCanBeRestarted=true, EcucPartitionId=1, EcucPartitionSoftwareComponentInstanceRef=ASWC_TrustedApp01
        EcucPartition_Trusted_02: PartitionCanBeRestarted=true, EcucPartitionId=3, EcucPartitionSoftwareComponentInstanceRef=ASWC_TrustedApp02
        EcucPartition_Trusted_Master: PartitionCanBeRestarted=false, EcucPartitionId=0, EcucDefaultBswPartition=true, EcucPartitionSoftwareComponentInstanceRef=Dcm, EcucPartitionSoftwareComponentInstanceRef=Dem, EcucPartitionSoftwareComponentInstanceRef=Fim, EcucPartitionSoftwareComponentInstanceRef=SCP_AppSd, EcucPartitionSoftwareComponentInstanceRef=SwCompPro_DemApp, EcucPartitionSoftwareComponentInstanceRef=App_SWC_Dcm, EcucPartitionSoftwareComponentInstanceRef=App_SWC_Dcm_Async, EcucPartitionSoftwareComponentInstanceRef=App_SWC_Dcm_Sync, EcucPartitionSoftwareComponentInstanceRef=App_SWC_Fim, EcucPartitionSoftwareComponentInstanceRef=NvM, EcucPartitionSoftwareComponentInstanceRef=App_SWC_NvM, EcucPartitionSoftwareComponentInstanceRef=BswM, EcucPartitionSoftwareComponentInstanceRef=EcuM, EcucPartitionSoftwareComponentInstanceRef=SWC, EcucPartitionSoftwareComponentInstanceRef=SwComponentComIPDUGrp, EcucPartitionSoftwareComponentInstanceRef=StbM, EcucPartitionSoftwareComponentInstanceRef=GlobalTimeProvider, EcucPartitionSoftwareComponentInstanceRef=App_BswmSd, EcucPartitionSoftwareComponentInstanceRef=ComM, EcucPartitionSoftwareComponentInstanceRef=DoIP, EcucPartitionSoftwareComponentInstanceRef=App_SWC_DoIP, EcucPartitionSoftwareComponentInstanceRef=KeyM_App, EcucPartitionSoftwareComponentInstanceRef=SCP_AppSd, EcucPartitionSoftwareComponentInstanceRef=KeyM, EcucPartitionSoftwareComponentInstanceRef=Csm, EcucPartitionSoftwareComponentInstanceRef=SecOC, EcucPartitionSoftwareComponentInstanceRef=SecOC_App, EcucPartitionSoftwareComponentInstanceRef=Csm_App, EcucPartitionSoftwareComponentInstanceRef=SOMEIP_EMS_SWC, EcucPartitionSoftwareComponentInstanceRef=Crypto, EcucPartitionSoftwareComponentInstanceRef=Crypto_App, EcucPartitionSoftwareComponentInstanceRef=Det, EcucPartitionSoftwareComponentInstanceRef=CSWC_Com, EcucPartitionSoftwareComponentInstanceRef=CSWC_NvM, EcucPartitionSoftwareComponentInstanceRef=StbM_App, EcucPartitionSoftwareComponentInstanceRef=SWC_E2E, EcucPartitionSoftwareComponentInstanceRef=IdsM, EcucPartitionSoftwareComponentInstanceRef=ASWC_TrustedMaster, EcucPartitionBswModuleDistinguishedPartition=CanIf_BswDistinguishedPartition, EcucPartitionBswModuleDistinguishedPartition=CanSM_BswDistinguishedPartition, EcucPartitionBswModuleDistinguishedPartition=Com_BswDistinguishedPartition, EcucPartitionBswModuleDistinguishedPartition=CryIf_BswDistinguishedPartition, EcucPartitionBswModuleDistinguishedPartition=Csm_BswDistinguishedPartition, EcucPartitionBswModuleDistinguishedPartition=Det_BswDistinguishedPartition, EcucPartitionBswModuleDistinguishedPartition=E2EXf_Integrator_BswDistinguishedPartition, EcucPartitionBswModuleDistinguishedPartition=EcuM_BswDistinguishedPartition, EcucPartitionBswModuleDistinguishedPartition=LdCom_BswDistinguishedPartition, EcucPartitionBswModuleDistinguishedPartition=MemIf_BswDistinguishedPartition, EcucPartitionBswModuleDistinguishedPartition=PduR_BswDistinguishedPartition, EcucPartitionBswModuleDistinguishedPartition=SecOC_BswDistinguishedPartition, EcucPartitionBswModuleDistinguishedPartition=SoAd_BswDistinguishedPartition, EcucPartitionBswModuleDistinguishedPartition=SomeIpXf_Integrator_BswDistinguishedPartition, EcucPartitionBswModuleDistinguishedPartition=Can_BswDistinguishedPartition, EcucPartitionBswModuleDistinguishedPartition=Eth_BswDistinguishedPartition, EcucPartitionBswModuleDistinguishedPartition=Icu_BswDistinguishedPartition
  module config LSduR_0: definition=LSduR, ecuc-def-edition=4.10.0, implementation-config-variant=VARIANT-PRE-COMPILE
    LSduRConfig_0 (LSduRConfig)
      6 x LSduRPath:
        LSduRPath_0
          EthMsg_T_0 (LSduRPathDestinationPdu): LSduRPathDestinationPduId=0, LSduRPathDestinationPduRef=Pdu_AVTP
          LSduRPathSourcePdu_0 (LSduRPathSourcePdu): LSduRPathSourcePduRef=(unset)
        LSduRPath_1
          EthMsg_T_1 (LSduRPathDestinationPdu): LSduRPathDestinationPduId=1, LSduRPathDestinationPduRef=Pdu_AuthenticData_Rx_SecOC_P3
          LSduRPathSourcePdu_0 (LSduRPathSourcePdu): LSduRPathSourcePduRef=(unset)
        LSduRPath_2
          EthMsg_R_0 (LSduRPathSourcePdu): LSduRPathSourcePduId=0, LSduRPathSourcePduRef=Pdu_AuthenticData_Rx
          LSduRPathDestinationPdu_0 (LSduRPathDestinationPdu): LSduRPathDestinationPduRef=(unset)
        LSduRPath_3
          EthMsg_R_1 (LSduRPathSourcePdu): LSduRPathSourcePduId=0, LSduRPathSourcePduRef=Pdu_AuthenticData_Rx_AEADD
          LSduRPathDestinationPdu_0 (LSduRPathDestinationPdu): LSduRPathDestinationPduRef=(unset)
        LSduRPath_4
          EthMsg_R_2 (LSduRPathSourcePdu): LSduRPathSourcePduId=0, LSduRPathSourcePduRef=Pdu_AuthenticData_Rx_Crypt
          LSduRPathDestinationPdu_0 (LSduRPathDestinationPdu): LSduRPathDestinationPduRef=(unset)
        LSduRPath_5
          EthMsg_R_3 (LSduRPathSourcePdu): LSduRPathSourcePduId=0, LSduRPathSourcePduRef=Pdu_AuthenticData_Rx_Dyn
          LSduRPathDestinationPdu_0 (LSduRPathDestinationPdu): LSduRPathDestinationPduRef=(unset)
    LSduRGeneral_0 (LSduRGeneral): LSduRDevErrorDetect=false, LSduRMetaDataSupport=(unset), LSduRVersionInfoApi=false, LSduRZeroCostOperation=(unset)
