AUTOSAR XML (schema 00053)
package /ARRoot
  module config EcuM_0: definition=EcuM, ecuc-def-edition=4.2.2, implementation-config-variant=VARIANT-PRE-COMPILE
    EcuMConfiguration_0 (EcuMConfiguration)
      EcuMCommonConfiguration_0 (EcuMCommonConfiguration): EcuMConfigConsistencyHash=(unset), EcuMDefaultAppMode=(unset), EcuMOSResource=(unset)
        EcuMDefaultShutdownTarget_0 (EcuMDefaultShutdownTarget): EcuMDefaultState=
        EcuMSleepMode_0 (EcuMSleepMode): EcuMSleepModeSuspend=(unset), EcuMSleepModeId=(unset), EcuMSleepModeMcuModeRef=(unset), EcuMWakeupSourceMask=(unset)
        EcuMWakeupSource_0 (EcuMWakeupSource): EcuMWakeupSourcePolling=(unset), EcuMWakeupSourceId=1
    EcuMGeneral_0 (EcuMGeneral): EcuMVersionInfoApi=(unset), EcuMDevErrorDetect=(unset), EcuMIncludeDet=(unset), EcuMMainFunctionPeriod=(unset)
  module config EthIf_0: definition=EthIf, implementation-config-variant=VARIANT-PRE-COMPILE, module-description=EthIf_Impl
    EthIfConfigSet_0 (EthIfConfigSet)
      4 x EthIfController, all with EthIfCtrlMtu=1500, EthIfMaxTxBufsTotal=2, EthIfEthTrcvRef=EthIfTransceiver_0:
        EthIfController_0: EthIfCtrlIdx=0, EthIfPhysControllerRef=EthIfPhysController_0
        EthIfController_1: EthIfCtrlIdx=1, EthIfPhysControllerRef=EthIfPhysController_1
        EthIfController_2: EthIfCtrlIdx=2, EthIfPhysControllerRef=EthIfPhysController_0
        EthIfController_3: EthIfCtrlIdx=3, EthIfPhysControllerRef=EthIfPhysController_1
      EthIfPhysController_0 (EthIfPhysController): EthIfPhysControllerIdx=0, EthIfEthCtrlRef=EthCtrlConfig_0
      EthIfPhysController_1 (EthIfPhysController): EthIfPhysControllerIdx=1, EthIfEthCtrlRef=EthCtrlConfig_1
      EthIfRxIndicationConfig_0 (EthIfRxIndicationConfig): EthIfRxIndicationFunction=TcpIp_RxIndication
      EthIfRxIndicationConfig_1 (EthIfRxIndicationConfig): EthIfRxIndicationFunction=Cdd_EthIfRxIndication
      EthIfSwitch_0 (EthIfSwitch): EthIfSwitchIdx=0, EthIfSwitchRef=EthSwtConfig_0
      EthIfTransceiver_0 (EthIfTransceiver): EthIfTransceiverIdx=0, EthIfEthTrcvRef=EthTrcvConfig_0
      EthIfTrcvLinkStateChgConfig_0 (EthIfTrcvLinkStateChgConfig): EthIfTrcvLinkStateChgFunction=EthSM_TrcvLinkStateChg
      EthIfTrcvLinkStateChgConfig_1 (EthIfTrcvLinkStateChgConfig): EthIfTrcvLinkStateChgFunction=Cdd_EthIfLinkStateChange
      EthIfTxConfirmationConfig_0 (EthIfTxConfirmationConfig): EthIfTxConfirmationFunction=Cdd_EthIfTxConfirmation
      EthIfFrameConfig_0 (EthIfFrameConfig): EthIfFrameType=2048, EthIfOwner=0
      EthIfFrameConfig_1 (EthIfFrameConfig): EthIfFrameType=2049, EthIfOwner=1
    EthIfGeneral_0 (EthIfGeneral):
      EthIfDevErrorDetect = true
      EthIfEnableRxInterrupt = false
      EthIfEnableTxInterrupt = false
      EthIfGetBaudRate = true
      EthIfGetCounterState = true
      EthIfGlobalTimeSupport = true
      EthIfMainFunctionPeriod = 0.005
      EthIfMaxTrcvsTotal = 2
      EthIfRxIndicationIterations = 5
      EthIfStartAutoNegotiation = true
      EthIfTrcvLinkStateChgMainReload = 1
      EthIfVersionInfoApi = true
      EthIfVersionInfoApiMacro = false
      EthIfWakeUpSupport = false
      EthIfPublicCddHeaderFile = Cdd
      EthIfEnableSecurityEventReporting = false
      EthIfEnableSignalQualityApi = false
      EthIfGetAndResetMeasurementDataApi = false
      EthIfGetCtrlIdxList = false
      EthIfGetVlanIdSupport = false
      EthIfVerifyConfigApi = false
      EthIfSwitchManagementSupport = false
      EthIfSetForwardingModeApi = false
      EthIfFwSupport = NO_FIREWALL
      EthIfPhcSupport = false
      EthIfMainFunctionStatePeriod = (unset)
  module config EthSwt_0: definition=EthSwt
    EthSwtConfig_0 (EthSwtConfig): EthSwtIdx=0
      EthSwtPort_0 (EthSwtPort): EthSwtPortEnableLinkDownCallback=, EthSwtPortIdx=, EthSwtPortPhysicalLayerType=
        EthSwtPortEgress_0 (EthSwtPortEgress): EthSwtPortEgressLastSchedulerRef=(unset)
          EthSwtPortFifo_0 (EthSwtPortFifo)
          EthSwtPortScheduler_0 (EthSwtPortScheduler): EthSwtPortSchedulerAlgorithm=
            EthSwtPortSchedulerPredecessor_0 (EthSwtPortSchedulerPredecessor): EthSwtPortSchedulerPredecessorOrder=, EthSwtPortEgressPredecessorRef=(unset)
        EthSwtPortIngress_0 (EthSwtPortIngress)
    EthSwtGeneral_0 (EthSwtGeneral):
      EthSwtDevErrorDetect = 
      EthSwtEnableVlanApi = 
      EthSwtGetArlTableApi = 
      EthSwtGetBufferLevelApi = 
      EthSwtGetDropCountApi = 
      EthSwtGetEtherStatsApi = 
      EthSwtGetMacLearningModeApi = 
      EthSwtGetPortMacAddrApi = 
      EthSwtGetSwitchRegApi = 
      EthSwtIndex = 
      EthSwtPersistentConfigurationResult = 
      EthSwtReadTrcvRegisterApi = 
      EthSwtResetConfigurationApi = 
      EthSwtSetMacLearningModeApi = 
      EthSwtSetSwitchRegApi = 
      EthSwtStoreConfigurationApi = 
      EthSwtVersionInfoApi = 
      EthSwtWriteTrcvRegisterApi = 
  module config EthTrcv_0: definition=EthTrcv, ecuc-def-edition=4.2.2, implementation-config-variant=VARIANT-PRE-COMPILE, module-description=EthTrcv_Impl
    EthTrcvConfigSet_0 (EthTrcvConfigSet)
      EthTrcvConfig_0 (EthTrcvConfig): EthTrcvAutoNegotiationEnabled=(unset), EthTrcvConnNeg=, EthTrcvCtrlIdx=0, EthTrcvDuplexMode=, EthTrcvIdx=0, EthTrcvMiiIdx=(unset), EthTrcvSpeed=
        EthTrcvWakeupMap_0 (EthTrcvWakeupMap): EthTrcvWakeupReason=ETHTRCV_WUR_GENERAL, EthTrcvWakeupSourceRef=EcuMWakeupSource_0
    EthTrcvGeneral_0 (EthTrcvGeneral):
      EthTrcvDevErrorDetect = (unset)
      EthTrcvGetBaudRateApi = (unset)
      EthTrcvGetDuplexModeApi = (unset)
      EthTrcvGetLinkStateApi = (unset)
      EthTrcvGetTransceiverModeApi = (unset)
      EthTrcvIndex = (unset)
      EthTrcvMaxTrcvsSupported = 1
      EthTrcvSetTransceiverModeApi = (unset)
      EthTrcvStartAutoNegotiationApi = (unset)
      EthTrcvVersionInfoApi = (unset)
      EthTrcvVersionInfoApiMacro = (unset)
      EthTrcvWakeUpSupport = ETHTRCV_WAKEUP_BY_POLLING
  module config Eth_0: definition=Eth
    EthConfigSet_0 (EthConfigSet)
      EthCtrlConfig_0 (EthCtrlConfig):
        EthCtrlEnableMii = 
        EthCtrlEnableRxInterrupt = 
        EthCtrlEnableTxInterrupt = 
        EthCtrlIdx = 0
        EthCtrlRxBufLenByte = 
        EthCtrlTxBufLenByte = 
        EthRxBufTotal = 
        EthTxBufTotal = 
        EthCtrlEnableEgressHardwareSupportedDataTransfer = false
        EthClkUnit_0 (EthClkUnit): EthClkUnitCrossTimestampingSupport=NO_XTIMESTAMPING, EthClkUnitIdx=0, EthClkUnitTimeStampingRef=(unset)
      EthCtrlConfig_1 (EthCtrlConfig):
        EthCtrlEnableMii = 
        EthCtrlEnableRxInterrupt = 
        EthCtrlEnableTxInterrupt = 
        EthCtrlIdx = 1
        EthCtrlRxBufLenByte = 
        EthCtrlTxBufLenByte = 
        EthRxBufTotal = 
        EthTxBufTotal = 
        EthCtrlEnableEgressHardwareSupportedDataTransfer = false
        EthClkUnit_0 (EthClkUnit): EthClkUnitCrossTimestampingSupport=NO_XTIMESTAMPING, EthClkUnitIdx=0, EthClkUnitTimeStampingRef=(unset)
    EthGeneral_0 (EthGeneral):
      EthDevErrorDetect = 
      EthGetDropCountApi = 
      EthGetEtherStatsApi = 
      EthGlobalTimeSupport = 
      EthIndex = 
      EthMainFunctionPeriod = 
      EthMaxCtrlsSupported = 
      EthUpdatePhysAddrFilter = false
      EthVersionInfoApi = 
      EthCtrlOffloading_0 (EthCtrlOffloading): EthCtrlEnableOffloadChecksumICMP=, EthCtrlEnableOffloadChecksumIPv4=, EthCtrlEnableOffloadChecksumTCP=, EthCtrlEnableOffloadChecksumUDP=
